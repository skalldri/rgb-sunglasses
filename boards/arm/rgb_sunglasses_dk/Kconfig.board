## boards/arm/rgb_sunglasses_dk/Kconfig.board
```kconfig
# nRF5340 DK NRF5340 board configuration

# Copyright (c) 2019-2020 Nordic Semiconductor ASA
# SPDX-License-Identifier: Apache-2.0

if SOC_NRF5340_CPUAPP_QKAA

config BOARD_RGB_SUNGLASSES_DK_CPUAPP
	bool "RGB Sunglasses DevKit nRF5340 Application MCU"

config BOARD_RGB_SUNGLASSES_DK_CPUAPP_NS
	bool "RGB Sunglasses DevKit Application MCU non-secure"

endif # SOC_NRF5340_CPUAPP_QKAA

config BOARD_RGB_SUNGLASSES_DK_CPUNET
	bool "RGB Sunglasses DevKit Network MCU"
	depends on SOC_NRF5340_CPUNET_QKAA
```

## drivers/bq25792/Kconfig
```kconfig
config BQ25792
    bool "Enable the BQ25792 driver"
    depends on I2C

config BQ25792_INIT_PRIORITY
    int "BQ25792 device initialization priority"
    default 3
```

## drivers/tps25750/Kconfig
```kconfig
config TPS25750
    bool "Enable the TPS25750 driver"
    depends on I2C

config TPS25750_INIT_PRIORITY
    int "TPS25750 device initialization priority"
    default 51

config TPS25750_PATCH_ON_STARTUP
    bool "Download the TPS25750 patch file on startup"
    default y
```

## drivers/vm3011/Kconfig
```kconfig
config VM3011
    bool "Enable the VM3011 driver"
    depends on I2C

config VM3011_INIT_PRIORITY
    int "BQ25792 device initialization priority"
    default 3
```

## fw/boards/others/rgb_sunglasses_dk/Kconfig
```kconfig
# nRF5340 DK board configuration

# Copyright (c) 2019 - 2021 Nordic Semiconductor ASA
# SPDX-License-Identifier: Apache-2.0

if BOARD_RGB_SUNGLASSES_DK_NRF5340_CPUAPP || BOARD_RGB_SUNGLASSES_DK_NRF5340_CPUAPP_NS

config BOARD_ENABLE_UICR_ACCESS
	bool "Enable application writes to the UICR flash"
	select SOC_FLASH_NRF_UICR
	default y

# Powering up the network core at boot is handled by the SoC-level
# SOC_NRF53_CPUNET_ENABLE symbol (see Kconfig.defconfig, which defaults it on
# when BT is enabled). The board-level BOARD_ENABLE_CPUNET symbol this file
# used to define is deprecated upstream (zephyr/soc/nordic/nrf53/Kconfig) and
# its cpunet_reset.c has been removed with it (issue #164): the SoC-level
# bring-up (nrf53_cpunet_mgmt.c) performs the same SPU secure retention, GPIO
# forwarding, and FORCEOFF release this project relied on. (cpunet_reset.c
# also had a BT_CTLR_DEBUG_PINS_CPUAPP debug-pin hook, but that symbol
# depends on the upstream nRF5340DK board and was unreachable here.)

endif #  BOARD_RGB_SUNGLASSES_DK_NRF5340_CPUAPP || BOARD_RGB_SUNGLASSES_DK_NRF5340_CPUAPP_NS
```

## fw/boards/others/rgb_sunglasses_dk/Kconfig.rgb_sunglasses_dk
```kconfig
config BOARD_RGB_SUNGLASSES_DK
	select SOC_NRF5340_CPUAPP_QKAA if BOARD_RGB_SUNGLASSES_DK_NRF5340_CPUAPP
	select SOC_NRF5340_CPUAPP_QKAA if BOARD_RGB_SUNGLASSES_DK_NRF5340_CPUAPP_NS
	select SOC_NRF5340_CPUNET_QKAA if BOARD_RGB_SUNGLASSES_DK_NRF5340_CPUNET
```

## fw/boards/others/rgb_sunglasses_dk/board.yml
```yaml
board:
  name: rgb_sunglasses_dk
  vendor: others
  socs:
  - name: nrf5340
    variants:
    - name: ns
      cpucluster: cpuapp
```

## fw/boards/others/rgb_sunglasses_proto0/Kconfig.rgb_sunglasses_proto0
```kconfig
config BOARD_RGB_SUNGLASSES_PROTO0
	select SOC_NRF5340_CPUAPP_QKAA if BOARD_RGB_SUNGLASSES_PROTO0_NRF5340_CPUAPP
	select SOC_NRF5340_CPUAPP_QKAA if BOARD_RGB_SUNGLASSES_PROTO0_NRF5340_CPUAPP_NS
	select SOC_NRF5340_CPUNET_QKAA if BOARD_RGB_SUNGLASSES_PROTO0_NRF5340_CPUNET
```

## fw/boards/others/rgb_sunglasses_proto0/board.yml
```yaml
board:
  name: rgb_sunglasses_proto0
  vendor: others
  socs:
  - name: nrf5340
    variants:
    - name: ns
      cpucluster: cpuapp
```

## fw/drivers/Kconfig
```kconfig
rsource "tps25750/Kconfig"
rsource "bq25792/Kconfig"
rsource "vm3011/Kconfig"
rsource "net_core_sim_flash/Kconfig"
```

## fw/drivers/emul_bmi270/Kconfig
```kconfig
config EMUL_BMI270
    bool "Emulate a Bosch BMI270 accel/gyro (native_sim tests)"
    depends on EMUL && BMI270
    help
      SPI register-file emulator for the Bosch BMI270 IMU. Satisfies the
      upstream bmi270 driver's full init handshake (chip id, soft reset,
      config-file upload, INTERNAL_STATUS poll) and lets tests inject
      accel/gyro samples via the sensor emulator backend API
      (emul_sensor_backend_set_channel). Only useful on native_sim; can
      never be enabled in hardware builds because CONFIG_EMUL is off there.
```

## fw/drivers/emul_tps25750/Kconfig
```kconfig
config EMUL_TPS25750
    bool "Emulate a TI TPS25750 USB-PD controller (native_sim tests)"
    depends on EMUL && TPS25750
    help
      I2C register-file emulator for the TPS25750 PD controller's host
      interface: the MODE/CMD1/DATA1 4CC task protocol, the I2Cm
      bridge (serving an embedded BQ25792 register file, so the real
      bq25792 driver works unmodified behind the real tps25750 bridge
      driver), and the PBMs/PBMc patch-download flow including the
      secondary patch-port I2C address. Only useful on native_sim; can
      never be enabled in hardware builds because CONFIG_EMUL is off
      there.

config EMUL_TPS25750_BOOT_MODE_PTCH
    bool "Emulated TPS25750 boots in PTCH mode (awaiting patch)"
    depends on EMUL_TPS25750
    default n
    help
      When enabled the emulated part powers up in "PTCH" mode with the
      ReadyForPatch interrupt bit set, so a driver built with
      CONFIG_TPS25750_INTERNAL_PATCH=y performs a full patch download
      during init. When disabled the part boots in "APP " mode (patch
      already loaded), matching proto0's normal EEPROM-booted state.
```

## fw/drivers/net_core_sim_flash/Kconfig
```kconfig
menuconfig NET_CORE_SIM_FLASH
	bool "Flash simulator"
	default y
	depends on DT_HAS_OTHER_NET_CORE_SIM_FLASH_ENABLED
	select FLASH_HAS_PAGE_LAYOUT
	select FLASH_HAS_DRIVER_ENABLED
	select FLASH_SIMULATOR
	help
	  Enable the flash simulator.


module = NET_CORE_SIM_FLASH
module-str = net_core_sim_flash
source "subsys/logging/Kconfig.template.log_config"
```

## fw/drivers/tps25750/Kconfig
```kconfig
config TPS25750
    bool "Enable the TPS25750 driver"
    depends on I2C || ZTEST

config TPS25750_INIT_PRIORITY
    int "TPS25750 device initialization priority"
    default 51

config TPS25750_INTERNAL_PATCH
    bool "Manage TPS25750 firmware patching inside the driver. Requires TPS25750_PATCH_HEADER_FILE to be set."
    default n

if TPS25750_INTERNAL_PATCH

config TPS25750_PATCH_HEADER_FILE
    string "Patch header file path"
    help
       Must contain several definitions:
       - #define TPS25750_PATCH_UNCOMPRESSED_SIZE (always)
       - #define TPS25750_PATCH_COMPRESSED_SIZE (if CONFIG_TPS25750_COMPRESSED_PATCH=y)
       - extern const char tps25750_patch[];

config TPS25750_COMPRESSED_PATCH
    bool "The TPS25750 patch file is compressed with LZ4 compression"
    default y
    depends on LZ4
    help
         If enabled, the driver will expect an LZ4-compressed patch, and decompress the patch one-time
         into RAM. The patch can be accessed via tps25750_get_patch().

config TPS25750_COMPRESSED_PATCH_PRELOAD
    bool "Decompress the TPS25750 patch during driver initialization"
    default n
    depends on TPS25750_COMPRESSED_PATCH
    help
         If enabled, the driver will decompress the patch during initialization. This increases
         initialization time, but ensures the patch is ready when needed.

endif
```

## fw/sysbuild/ipc_radio/boards/rgb_sunglasses_proto0_nrf5340_cpunet.conf
```kconfig
# Declare the 32k sleep clock as 500ppm-class on proto0 (issue #188 hardware finding).
#
# The board's LFXO crystal is out of the accuracy class the controller assumed
# (~50-250ppm): with the tighter declaration, any LE connection whose interval was
# renegotiated to >= ~120ms deterministically died of supervision timeout ("Disconnected
# (reason 8)") exactly one supervision window after the update, on BOTH test phones
# (OnePlus 9 Pro / OxygenOS 14 AND Pixel 9 Pro / Android 16) - the peripheral's RX
# window widening (Core v5 Vol 6 Part B 4.5.7 - scales with interval x SCA) was too
# narrow to catch the anchor, so the radio never heard the central again. Intervals
# <= ~105ms survived (drift per event still inside the window). Declaring 500ppm makes
# the controller widen honestly; hardware-verified: the same 165ms/latency-2 link that
# died in <7s now runs indefinitely (incl. through a full SMP DFU cycle). Known Nordic
# failure mode - see the matching DevZone case cited in the issue-#188 PR verification notes.
#
# Follow-up (crystal load caps / board rework) tracked in its own issue; until the
# hardware is fixed this declaration is REQUIRED for the conn-param governor's SLOW set.
CONFIG_CLOCK_CONTROL_NRF_K32SRC_500PPM=y
```

## fw/sysbuild/mcuboot/boards/rgb_sunglasses_proto0_nrf5340_cpuapp.conf
```kconfig
# Proto0-specific mcuboot overrides.
#
# The proto0 board DTS exposes an enabled QSPI node (MX25R6435F), which causes
# CONFIG_NORDIC_QSPI_NOR to be auto-selected (default y). mcuboot needs the
# QSPI NOR driver because the secondary OTA slots will live on the external
# MX25R6435F flash. The driver adds ~4.5 KB to the mcuboot binary, so the
# mcuboot partition is enlarged from the shared default of 64 KB to 80 KB.
# The 16 KB is recovered many times over once secondary slots move to QSPI
# (freeing the ~384 KB internal-flash secondary slot + 120 KB scratch region).
#
# TODO: evaluate switching from RSA-2048 to ECDSA-P256 (CONFIG_BOOT_SIGNATURE_TYPE_ECDSA_P256)
#       which would save 3-5 KB of MbedTLS crypto code and restore comfortable headroom.
CONFIG_NORDIC_QSPI_NOR=y
CONFIG_PM_PARTITION_SIZE_MCUBOOT=0x14000

# Primary slot is 880 KB (0xDC000 = 220 × 4 KB sectors — shrunk when the coredump
# partition was carved from the end of internal flash, issue #80). The default of
# 128 is too small; 256 covers the full slot with headroom for future growth.
CONFIG_BOOT_MAX_IMG_SECTORS=256

# Enter serial recovery (DFU) mode when button1 (sw1, P1.11) is held at boot.
# The mcuboot-button0 DTS alias already points to &button1.
# 500 ms hold prevents accidental entry on a normal power-on press.
CONFIG_BOOT_SERIAL_ENTRANCE_GPIO=y
CONFIG_BOOT_SERIAL_DETECT_DELAY=500

# Share MCUboot's own version with the app via retained SRAM (blinfo TLV).
# The app reads it via blinfo_lookup(BLINFO_BOOTLOADER_VERSION).
# Not enabled on rgb_sunglasses_dk: that board has no retained-SRAM DTS node,
# and the feature is gated by CONFIG_APP_MCUBOOT_INFO_SERVICE (see fw/Kconfig).
CONFIG_BOOT_SHARE_DATA=y
CONFIG_BOOT_SHARE_DATA_BOOTINFO=y
CONFIG_BOOT_SHARE_BACKEND_RETENTION=y
CONFIG_RETAINED_MEM=y
CONFIG_RETENTION=y

# Disable MCUboot's built-in SPU write-protection call.  fprotect_hook.c
# (fw/mcuboot_hooks/) re-implements the same protection but reads the
# gpregret2 retention register first: a normal boot applies fprotect exactly
# as before; an updater-mode boot (app wrote BOOT_MODE_UPDATER_REQ=0xB1)
# skips it and sets BOOT_MODE_UPDATER_ACTIVE=0xB2 so the app can verify the
# region is writable.  The BLE update path still requires BT_SECURITY_L4 +
# two-step confirmation.
CONFIG_FPROTECT=n
CONFIG_BOOT_GO_HOOKS=y

# Retention subsystem — already enabled for BOOT_SHARE_BACKEND_RETENTION above,
# but also needed here for bootmode_check/set (zephyr,boot-mode on gpregret2).
CONFIG_RETENTION_BOOT_MODE=y
```

## fw/tests/animations/animation_base/testcase.yaml
```yaml
tests:
  animations.animation_base:
    platform_allow:
      - native_sim
    integration_platforms:
      - native_sim
```

## fw/tests/animations/animation_is_active_binding/testcase.yaml
```yaml
tests:
  animations.animation_is_active_binding:
    platform_allow:
      - native_sim
    integration_platforms:
      - native_sim
```

## fw/tests/animations/bad_apple_animation_di/testcase.yaml
```yaml
tests:
  animations.bad_apple_animation_di:
    platform_allow:
      - native_sim
    integration_platforms:
      - native_sim
    tags: animations bad_apple
```

## fw/tests/animations/bt_animations_di/testcase.yaml
```yaml
tests:
  animations.bt_animations_di:
    platform_allow:
      - native_sim
    integration_platforms:
      - native_sim
```

## fw/tests/animations/glim_player_animation_di/testcase.yaml
```yaml
tests:
  animations.glim_player_animation_di:
    platform_allow:
      - native_sim
    integration_platforms:
      - native_sim
    tags: animations glim
```

## fw/tests/animations/my_eyes_animation_di/testcase.yaml
```yaml
tests:
  animations.my_eyes_animation_di:
    platform_allow:
      - native_sim
    integration_platforms:
      - native_sim
```

## fw/tests/animations/null_animation_di/testcase.yaml
```yaml
tests:
  animations.null_animation_di:
    platform_allow:
      - native_sim
    integration_platforms:
      - native_sim
```

## fw/tests/animations/nyan_cat_animation_di/testcase.yaml
```yaml
tests:
  animations.nyan_cat_animation_di:
    platform_allow:
      - native_sim
    integration_platforms:
      - native_sim
    tags: animations nyan_cat
```
