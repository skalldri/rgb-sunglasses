## CMakeLists.txt
```
# SPDX-License-Identifier: Apache-2.0

cmake_minimum_required(VERSION 3.20.0)
find_package(Zephyr REQUIRED HINTS $ENV{ZEPHYR_BASE})
project(wasm_mvp_runtime_tests)

set(FW_ROOT ${CMAKE_CURRENT_LIST_DIR}/../../..)

# These are ordinary Kconfig values in the firmware application. The focused
# QEMU test compiles the same runtime source without importing the whole
# product Kconfig tree, so keep its bounded test profile explicit here.
set(CONFIG_APP_WASM3_MVP_HEAP_SIZE 16384)
target_compile_definitions(app PRIVATE
  CONFIG_APP_WASM3_MVP_HEAP_SIZE=16384
  CONFIG_APP_WASM3_MVP=1
  CONFIG_APP_WASM3_V2_PROTOTYPE=1
  CONFIG_APP_WASM3_V2_ADMISSION_CPU_BUDGET_MS=250
  CONFIG_APP_WASM3_MVP_VALUE_STACK_SIZE=2048
  CONFIG_APP_WASM3_MVP_MODULE_MAX_SIZE=2048
  CONFIG_APP_WASM3_MVP_THREAD_PRIORITY=9
  CONFIG_APP_WASM3_MVP_THREAD_STACK_SIZE=4096
  CONFIG_APP_WASM3_MVP_CPU_BUDGET_MS=50
  CONFIG_APP_WASM3_MVP_WALL_BACKSTOP_MS=500
  CONFIG_APP_PATTERN_CONTROLLER_THREAD_PRIORITY=4
)

add_subdirectory(${FW_ROOT}/third_party/wasm3 wasm3)
target_link_libraries(app PRIVATE rgbx_wasm3)

target_sources(app PRIVATE
  src/main.cpp
  ${FW_ROOT}/src/extensions/wasm_mvp_runtime.cpp
  ${FW_ROOT}/src/extensions/sandbox_fatal_handler.cpp
  # The end-to-end test admits a real SDK package through these before running
  # its module, proving one artifact is both parseable and executable.
  ${FW_ROOT}/src/extensions/rgbx_package.cpp
  ${FW_ROOT}/src/extensions/rgbx_package_psa.cpp
)

target_include_directories(app PRIVATE
  ${FW_ROOT}/src
  ${FW_ROOT}/include
  ${FW_ROOT}/third_party/wasm3
  ${FW_ROOT}/third_party/wasm3/source
  # The committed package fixture is shared with the rgbx_package suite so there
  # is one generated artifact, regenerated and cmp'd by CI.
  ${FW_ROOT}/tests/extensions/rgbx_package/src
)

# The end-to-end test asserts the package's recorded source digest is the
# SHA-256 of the exact source the SDK consumer compiled.
set(_rgbx_v2_test_source ${FW_ROOT}/sdk/tests/consumer/rgbx_v2_test.c)
file(SHA256 ${_rgbx_v2_test_source} _rgbx_v2_test_source_sha256)
target_compile_definitions(app PRIVATE
  RGBX_V2_TEST_SOURCE_SHA256="${_rgbx_v2_test_source_sha256}")
```

## prj.conf
```kconfig
CONFIG_ZTEST=y
CONFIG_CPP=y
CONFIG_STD_CPP2B=y
CONFIG_REQUIRES_FULL_LIBCPP=y
CONFIG_REQUIRES_FULL_LIBC=y
CONFIG_USERSPACE=y
CONFIG_THREAD_RUNTIME_STATS=y
CONFIG_INIT_STACKS=y
CONFIG_THREAD_STACK_INFO=y

# The end-to-end test admits a real SDK package through the on-device CBOR
# parser and PSA SHA-256 verifier before executing it, so this suite pulls in
# the same zcbor + mbedtls PSA the rgbx_package suite uses.
CONFIG_ZCBOR=y
CONFIG_ZCBOR_CANONICAL=y
CONFIG_MBEDTLS=y
CONFIG_MBEDTLS_PSA_CRYPTO_C=y
CONFIG_PSA_WANT_ALG_SHA_256=y
```

## src/cpptest_v2_module.h
```c
#pragma once

#include <cstddef>
#include <cstdint>

// Compiler-inlined, memoryless form of fw/extensions/cpptest/cpptest_v2.c.
// Checked in so firmware tests do not depend on a host-side Wasm compiler.
inline constexpr uint8_t kCppTestV2Module[] = {
    0x00, 0x61, 0x73, 0x6d, 0x01, 0x00, 0x00, 0x00, 0x01, 0x19, 0x04, 0x60, 0x01, 0x7f, 0x01, 0x7f,
    0x60, 0x09, 0x7f, 0x7f, 0x7f, 0x7f, 0x7f, 0x7f, 0x7f, 0x7f, 0x7f, 0x00, 0x60, 0x00, 0x00, 0x60,
    0x01, 0x7f, 0x00, 0x02, 0x29, 0x02, 0x07, 0x72, 0x67, 0x62, 0x78, 0x5f, 0x76, 0x32, 0x09, 0x70,
    0x61, 0x72, 0x61, 0x6d, 0x5f, 0x75, 0x33, 0x32, 0x00, 0x00, 0x07, 0x72, 0x67, 0x62, 0x78, 0x5f,
    0x76, 0x32, 0x09, 0x73, 0x65, 0x74, 0x5f, 0x73, 0x70, 0x61, 0x6e, 0x38, 0x00, 0x01, 0x03, 0x03,
    0x02, 0x02, 0x03, 0x06, 0x0b, 0x02, 0x7f, 0x01, 0x41, 0x00, 0x0b, 0x7f, 0x01, 0x41, 0x00, 0x0b,
    0x07, 0x19, 0x02, 0x09, 0x72, 0x67, 0x62, 0x78, 0x5f, 0x69, 0x6e, 0x69, 0x74, 0x00, 0x02, 0x09,
    0x72, 0x67, 0x62, 0x78, 0x5f, 0x74, 0x69, 0x63, 0x6b, 0x00, 0x03, 0x0a, 0xd3, 0x09, 0x02, 0x06,
    0x00, 0x41, 0x00, 0x24, 0x01, 0x0b, 0xc9, 0x09, 0x01, 0x0f, 0x7f, 0x41, 0x00, 0x10, 0x00, 0x20,
    0x00, 0x6c, 0x41, 0x32, 0x6e, 0x23, 0x01, 0x6a, 0x24, 0x01, 0x41, 0x01, 0x10, 0x00, 0x22, 0x00,
    0x41, 0xff, 0x01, 0x71, 0x21, 0x01, 0x20, 0x00, 0x41, 0x08, 0x76, 0x41, 0xff, 0x01, 0x71, 0x21,
    0x02, 0x20, 0x00, 0x41, 0x10, 0x76, 0x41, 0xff, 0x01, 0x71, 0x21, 0x03, 0x41, 0x2c, 0x21, 0x04,
    0x41, 0x02, 0x10, 0x00, 0x21, 0x05, 0x41, 0x00, 0x21, 0x06, 0x41, 0x00, 0x21, 0x07, 0x03, 0x40,
    0x20, 0x07, 0x41, 0x17, 0x6c, 0x21, 0x08, 0x41, 0x78, 0x21, 0x09, 0x41, 0x34, 0x21, 0x0a, 0x20,
    0x04, 0x21, 0x0b, 0x03, 0x40, 0x20, 0x09, 0x41, 0x08, 0x6a, 0x22, 0x09, 0x20, 0x06, 0x6a, 0x41,
    0xff, 0x01, 0x41, 0x00, 0x20, 0x0b, 0x23, 0x01, 0x22, 0x0c, 0x41, 0x06, 0x6e, 0x6a, 0x22, 0x00,
    0x41, 0x54, 0x6a, 0x22, 0x0d, 0x41, 0xff, 0x00, 0x71, 0x22, 0x0e, 0x41, 0xff, 0x00, 0x73, 0x20,
    0x0e, 0x6c, 0x41, 0x05, 0x76, 0x22, 0x0e, 0x6b, 0x20, 0x0e, 0x20, 0x0d, 0x41, 0x80, 0x01, 0x71,
    0x1b, 0x41, 0x00, 0x20, 0x0a, 0x20, 0x0c, 0x41, 0x09, 0x6e, 0x6a, 0x22, 0x0d, 0x41, 0x4c, 0x6a,
    0x22, 0x0e, 0x41, 0xff, 0x00, 0x71, 0x22, 0x0f, 0x41, 0xff, 0x00, 0x73, 0x20, 0x0f, 0x6c, 0x41,
    0x05, 0x76, 0x22, 0x0f, 0x6b, 0x20, 0x0f, 0x20, 0x0e, 0x41, 0x80, 0x01, 0x71, 0x1b, 0x6a, 0x41,
    0x00, 0x20, 0x0c, 0x41, 0x0e, 0x6e, 0x20, 0x08, 0x6a, 0x22, 0x0c, 0x41, 0xff, 0x00, 0x71, 0x22,
    0x0e, 0x41, 0xff, 0x00, 0x73, 0x20, 0x0e, 0x6c, 0x41, 0x05, 0x76, 0x22, 0x0e, 0x6b, 0x20, 0x0e,
    0x20, 0x0c, 0x41, 0x80, 0x01, 0x71, 0x1b, 0x41, 0x80, 0x03, 0x6a, 0x22, 0x0c, 0x6a, 0x41, 0x03,
    0x6e, 0x22, 0x0e, 0x6b, 0x20, 0x0e, 0x20, 0x05, 0x1b, 0x22, 0x0e, 0x20, 0x02, 0x6c, 0x41, 0xff,
    0x01, 0x6e, 0x41, 0x08, 0x74, 0x20, 0x0e, 0x20, 0x01, 0x6c, 0x41, 0xff, 0x01, 0x6e, 0x72, 0x20,
    0x0e, 0x20, 0x03, 0x6c, 0x41, 0xff, 0x01, 0x6e, 0x41, 0x10, 0x74, 0x72, 0x41, 0xff, 0x01, 0x41,
    0x00, 0x20, 0x00, 0x41, 0x5f, 0x6a, 0x22, 0x0e, 0x41, 0xff, 0x00, 0x71, 0x22, 0x0f, 0x41, 0xff,
    0x00, 0x73, 0x20, 0x0f, 0x6c, 0x41, 0x05, 0x76, 0x22, 0x0f, 0x6b, 0x20, 0x0f, 0x20, 0x0e, 0x41,
    0x80, 0x01, 0x71, 0x1b, 0x41, 0x00, 0x20, 0x0d, 0x41, 0x59, 0x6a, 0x22, 0x0e, 0x41, 0xff, 0x00,
    0x71, 0x22, 0x0f, 0x41, 0xff, 0x00, 0x73, 0x20, 0x0f, 0x6c, 0x41, 0x05, 0x76, 0x22, 0x0f, 0x6b,
    0x20, 0x0f, 0x20, 0x0e, 0x41, 0x80, 0x01, 0x71, 0x1b, 0x6a, 0x20, 0x0c, 0x6a, 0x41, 0x03, 0x6e,
    0x22, 0x0e, 0x6b, 0x20, 0x0e, 0x20, 0x05, 0x1b, 0x22, 0x0e, 0x20, 0x02, 0x6c, 0x41, 0xff, 0x01,
    0x6e, 0x41, 0x08, 0x74, 0x20, 0x0e, 0x20, 0x01, 0x6c, 0x41, 0xff, 0x01, 0x6e, 0x72, 0x20, 0x0e,
    0x20, 0x03, 0x6c, 0x41, 0xff, 0x01, 0x6e, 0x41, 0x10, 0x74, 0x72, 0x41, 0xff, 0x01, 0x41, 0x00,
    0x20, 0x00, 0x41, 0x6a, 0x6a, 0x22, 0x0e, 0x41, 0xff, 0x00, 0x71, 0x22, 0x0f, 0x41, 0xff, 0x00,
    0x73, 0x20, 0x0f, 0x6c, 0x41, 0x05, 0x76, 0x22, 0x0f, 0x6b, 0x20, 0x0f, 0x20, 0x0e, 0x41, 0x80,
    0x01, 0x71, 0x1b, 0x41, 0x00, 0x20, 0x0d, 0x41, 0x66, 0x6a, 0x22, 0x0e, 0x41, 0xff, 0x00, 0x71,
    0x22, 0x0f, 0x41, 0xff, 0x00, 0x73, 0x20, 0x0f, 0x6c, 0x41, 0x05, 0x76, 0x22, 0x0f, 0x6b, 0x20,
    0x0f, 0x20, 0x0e, 0x41, 0x80, 0x01, 0x71, 0x1b, 0x6a, 0x20, 0x0c, 0x6a, 0x41, 0x03, 0x6e, 0x22,
    0x0e, 0x6b, 0x20, 0x0e, 0x20, 0x05, 0x1b, 0x22, 0x0e, 0x20, 0x02, 0x6c, 0x41, 0xff, 0x01, 0x6e,
    0x41, 0x08, 0x74, 0x20, 0x0e, 0x20, 0x01, 0x6c, 0x41, 0xff, 0x01, 0x6e, 0x72, 0x20, 0x0e, 0x20,
    0x03, 0x6c, 0x41, 0xff, 0x01, 0x6e, 0x41, 0x10, 0x74, 0x72, 0x41, 0xff, 0x01, 0x41, 0x00, 0x20,
    0x00, 0x41, 0x75, 0x6a, 0x22, 0x0e, 0x41, 0xff, 0x00, 0x71, 0x22, 0x0f, 0x41, 0xff, 0x00, 0x73,
    0x20, 0x0f, 0x6c, 0x41, 0x05, 0x76, 0x22, 0x0f, 0x6b, 0x20, 0x0f, 0x20, 0x0e, 0x41, 0x80, 0x01,
    0x71, 0x1b, 0x41, 0x00, 0x20, 0x0d, 0x41, 0x73, 0x6a, 0x22, 0x0e, 0x41, 0xff, 0x00, 0x71, 0x22,
    0x0f, 0x41, 0xff, 0x00, 0x73, 0x20, 0x0f, 0x6c, 0x41, 0x05, 0x76, 0x22, 0x0f, 0x6b, 0x20, 0x0f,
    0x20, 0x0e, 0x41, 0x80, 0x01, 0x71, 0x1b, 0x6a, 0x20, 0x0c, 0x6a, 0x41, 0x03, 0x6e, 0x22, 0x0e,
    0x6b, 0x20, 0x0e, 0x20, 0x05, 0x1b, 0x22, 0x0e, 0x20, 0x02, 0x6c, 0x41, 0xff, 0x01, 0x6e, 0x41,
    0x08, 0x74, 0x20, 0x0e, 0x20, 0x01, 0x6c, 0x41, 0xff, 0x01, 0x6e, 0x72, 0x20, 0x0e, 0x20, 0x03,
    0x6c, 0x41, 0xff, 0x01, 0x6e, 0x41, 0x10, 0x74, 0x72, 0x41, 0xff, 0x01, 0x41, 0x00, 0x20, 0x00,
    0x41, 0xff, 0x00, 0x71, 0x22, 0x0e, 0x41, 0xff, 0x00, 0x73, 0x20, 0x0e, 0x6c, 0x41, 0x05, 0x76,
    0x22, 0x0e, 0x6b, 0x20, 0x0e, 0x20, 0x00, 0x41, 0x80, 0x01, 0x71, 0x1b, 0x41, 0x00, 0x20, 0x0d,
    0x41, 0xff, 0x00, 0x71, 0x22, 0x0e, 0x41, 0xff, 0x00, 0x73, 0x20, 0x0e, 0x6c, 0x41, 0x05, 0x76,
    0x22, 0x0e, 0x6b, 0x20, 0x0e, 0x20, 0x0d, 0x41, 0x80, 0x01, 0x71, 0x1b, 0x6a, 0x20, 0x0c, 0x6a,
    0x41, 0x03, 0x6e, 0x22, 0x0e, 0x6b, 0x20, 0x0e, 0x20, 0x05, 0x1b, 0x22, 0x0e, 0x20, 0x02, 0x6c,
    0x41, 0xff, 0x01, 0x6e, 0x41, 0x08, 0x74, 0x20, 0x0e, 0x20, 0x01, 0x6c, 0x41, 0xff, 0x01, 0x6e,
    0x72, 0x20, 0x0e, 0x20, 0x03, 0x6c, 0x41, 0xff, 0x01, 0x6e, 0x41, 0x10, 0x74, 0x72, 0x41, 0xff,
    0x01, 0x41, 0x00, 0x20, 0x00, 0x41, 0x0b, 0x6a, 0x22, 0x0e, 0x41, 0xff, 0x00, 0x71, 0x22, 0x0f,
    0x41, 0xff, 0x00, 0x73, 0x20, 0x0f, 0x6c, 0x41, 0x05, 0x76, 0x22, 0x0f, 0x6b, 0x20, 0x0f, 0x20,
    0x0e, 0x41, 0x80, 0x01, 0x71, 0x1b, 0x41, 0x00, 0x20, 0x0d, 0x41, 0x0d, 0x6a, 0x22, 0x0e, 0x41,
    0xff, 0x00, 0x71, 0x22, 0x0f, 0x41, 0xff, 0x00, 0x73, 0x20, 0x0f, 0x6c, 0x41, 0x05, 0x76, 0x22,
    0x0f, 0x6b, 0x20, 0x0f, 0x20, 0x0e, 0x41, 0x80, 0x01, 0x71, 0x1b, 0x6a, 0x20, 0x0c, 0x6a, 0x41,
    0x03, 0x6e, 0x22, 0x0e, 0x6b, 0x20, 0x0e, 0x20, 0x05, 0x1b, 0x22, 0x0e, 0x20, 0x02, 0x6c, 0x41,
    0xff, 0x01, 0x6e, 0x41, 0x08, 0x74, 0x20, 0x0e, 0x20, 0x01, 0x6c, 0x41, 0xff, 0x01, 0x6e, 0x72,
    0x20, 0x0e, 0x20, 0x03, 0x6c, 0x41, 0xff, 0x01, 0x6e, 0x41, 0x10, 0x74, 0x72, 0x41, 0xff, 0x01,
    0x41, 0x00, 0x20, 0x00, 0x41, 0x16, 0x6a, 0x22, 0x0e, 0x41, 0xff, 0x00, 0x71, 0x22, 0x0f, 0x41,
    0xff, 0x00, 0x73, 0x20, 0x0f, 0x6c, 0x41, 0x05, 0x76, 0x22, 0x0f, 0x6b, 0x20, 0x0f, 0x20, 0x0e,
    0x41, 0x80, 0x01, 0x71, 0x1b, 0x41, 0x00, 0x20, 0x0d, 0x41, 0x1a, 0x6a, 0x22, 0x0e, 0x41, 0xff,
    0x00, 0x71, 0x22, 0x0f, 0x41, 0xff, 0x00, 0x73, 0x20, 0x0f, 0x6c, 0x41, 0x05, 0x76, 0x22, 0x0f,
    0x6b, 0x20, 0x0f, 0x20, 0x0e, 0x41, 0x80, 0x01, 0x71, 0x1b, 0x6a, 0x20, 0x0c, 0x6a, 0x41, 0x03,
    0x6e, 0x22, 0x0e, 0x6b, 0x20, 0x0e, 0x20, 0x05, 0x1b, 0x22, 0x0e, 0x20, 0x02, 0x6c, 0x41, 0xff,
    0x01, 0x6e, 0x41, 0x08, 0x74, 0x20, 0x0e, 0x20, 0x01, 0x6c, 0x41, 0xff, 0x01, 0x6e, 0x72, 0x20,
    0x0e, 0x20, 0x03, 0x6c, 0x41, 0xff, 0x01, 0x6e, 0x41, 0x10, 0x74, 0x72, 0x41, 0xff, 0x01, 0x41,
    0x00, 0x20, 0x00, 0x41, 0x21, 0x6a, 0x22, 0x00, 0x41, 0xff, 0x00, 0x71, 0x22, 0x0e, 0x41, 0xff,
    0x00, 0x73, 0x20, 0x0e, 0x6c, 0x41, 0x05, 0x76, 0x22, 0x0e, 0x6b, 0x20, 0x0e, 0x20, 0x00, 0x41,
    0x80, 0x01, 0x71, 0x1b, 0x41, 0x00, 0x20, 0x0d, 0x41, 0x27, 0x6a, 0x22, 0x00, 0x41, 0xff, 0x00,
    0x71, 0x22, 0x0d, 0x41, 0xff, 0x00, 0x73, 0x20, 0x0d, 0x6c, 0x41, 0x05, 0x76, 0x22, 0x0d, 0x6b,
    0x20, 0x0d, 0x20, 0x00, 0x41, 0x80, 0x01, 0x71, 0x1b, 0x6a, 0x20, 0x0c, 0x6a, 0x41, 0x03, 0x6e,
    0x22, 0x00, 0x6b, 0x20, 0x00, 0x20, 0x05, 0x1b, 0x22, 0x00, 0x20, 0x02, 0x6c, 0x41, 0xff, 0x01,
    0x6e, 0x41, 0x08, 0x74, 0x20, 0x00, 0x20, 0x01, 0x6c, 0x41, 0xff, 0x01, 0x6e, 0x72, 0x20, 0x00,
    0x20, 0x03, 0x6c, 0x41, 0xff, 0x01, 0x6e, 0x41, 0x10, 0x74, 0x72, 0x10, 0x01, 0x20, 0x0a, 0x41,
    0xe8, 0x00, 0x6a, 0x21, 0x0a, 0x20, 0x0b, 0x41, 0xd8, 0x00, 0x6a, 0x21, 0x0b, 0x20, 0x09, 0x41,
    0x20, 0x49, 0x0d, 0x00, 0x0b, 0x20, 0x04, 0x41, 0x0b, 0x6a, 0x21, 0x04, 0x20, 0x06, 0x41, 0x28,
    0x6a, 0x21, 0x06, 0x20, 0x07, 0x41, 0x01, 0x6a, 0x22, 0x07, 0x41, 0x0c, 0x47, 0x0d, 0x00, 0x0b,
    0x0b,
};

static_assert(sizeof(kCppTestV2Module) == 1361);
```

## src/plasma_v2_sdk_module.h
```c
#pragma once

#include <cstddef>
#include <cstdint>

// SPDX-License-Identifier: MIT
// Copyright (c) 2026 Stuart Alldritt
// Full permission notice: fw/tests/extensions/wasm_mvp_runtime/src/plasma_v2_sdk_module.LICENSE.
// Generated by the release-pinned RGBX v2 SDK consumer build.
// SHA-256: 78506a11c786abc2085bb77c9982418b2a5e27c3242a9b85d04e5320ba8e1b24.
inline constexpr uint8_t kPlasmaV2SdkModule[] = {
    0x00, 0x61, 0x73, 0x6d, 0x01, 0x00, 0x00, 0x00, 0x01, 0x1f, 0x05, 0x60, 0x01, 0x7f, 0x01, 0x7f,
    0x60, 0x0b, 0x7f, 0x7f, 0x7f, 0x7f, 0x7f, 0x7f, 0x7f, 0x7f, 0x7f, 0x7f, 0x7f, 0x00, 0x60, 0x00,
    0x00, 0x60, 0x01, 0x7f, 0x00, 0x60, 0x00, 0x01, 0x7f, 0x02, 0x2e, 0x02, 0x07, 0x72, 0x67, 0x62,
    0x78, 0x5f, 0x76, 0x32, 0x09, 0x70, 0x61, 0x72, 0x61, 0x6d, 0x5f, 0x75, 0x33, 0x32, 0x00, 0x00,
    0x07, 0x72, 0x67, 0x62, 0x78, 0x5f, 0x76, 0x32, 0x0e, 0x73, 0x65, 0x74, 0x5f, 0x6c, 0x75, 0x6d,
    0x61, 0x5f, 0x73, 0x70, 0x61, 0x6e, 0x38, 0x00, 0x01, 0x03, 0x05, 0x04, 0x02, 0x03, 0x04, 0x00,
    0x06, 0x0d, 0x02, 0x7f, 0x01, 0x41, 0x80, 0x80, 0x04, 0x0b, 0x7f, 0x01, 0x41, 0x00, 0x0b, 0x07,
    0x19, 0x02, 0x09, 0x72, 0x67, 0x62, 0x78, 0x5f, 0x69, 0x6e, 0x69, 0x74, 0x00, 0x02, 0x09, 0x72,
    0x67, 0x62, 0x78, 0x5f, 0x74, 0x69, 0x63, 0x6b, 0x00, 0x03, 0x0a, 0xb2, 0x0d, 0x04, 0x06, 0x00,
    0x41, 0x00, 0x24, 0x01, 0x0b, 0x81, 0x0a, 0x03, 0x03, 0x7f, 0x01, 0x7e, 0x0e, 0x7f, 0x41, 0x00,
    0x10, 0x00, 0x21, 0x01, 0x23, 0x01, 0x20, 0x01, 0xad, 0x20, 0x00, 0xad, 0x7e, 0x42, 0x32, 0x80,
    0x42, 0xf0, 0xea, 0x03, 0x82, 0xa7, 0x6a, 0x41, 0xf0, 0xea, 0x03, 0x70, 0x24, 0x01, 0x41, 0x01,
    0x10, 0x00, 0x21, 0x02, 0x41, 0x02, 0x10, 0x00, 0x21, 0x01, 0x41, 0x03, 0x10, 0x00, 0x21, 0x03,
    0x10, 0x04, 0xad, 0x22, 0x04, 0x42, 0x80, 0x80, 0xc0, 0x05, 0x7e, 0x42, 0x90, 0xce, 0x00, 0x80,
    0xa7, 0x22, 0x00, 0x10, 0x05, 0x21, 0x05, 0x20, 0x00, 0x41, 0xfb, 0xc3, 0xe4, 0x00, 0x6a, 0x10,
    0x05, 0x41, 0x9e, 0x44, 0x6c, 0x20, 0x05, 0x41, 0xf7, 0xf8, 0x01, 0x6c, 0x6a, 0x22, 0x00, 0x20,
    0x00, 0x41, 0x1f, 0x75, 0x6a, 0x41, 0x80, 0x80, 0x01, 0x6a, 0x41, 0x0f, 0x75, 0x21, 0x06, 0x20,
    0x04, 0x42, 0x80, 0x80, 0xc0, 0x03, 0x7e, 0x42, 0x90, 0xce, 0x00, 0x80, 0xa7, 0x22, 0x07, 0x10,
    0x05, 0x21, 0x00, 0x20, 0x07, 0x41, 0xfb, 0xc3, 0xe4, 0x00, 0x6a, 0x10, 0x05, 0x21, 0x08, 0x20,
    0x04, 0x42, 0x80, 0x80, 0xc0, 0x08, 0x7e, 0x42, 0x90, 0xce, 0x00, 0x80, 0xa7, 0x22, 0x07, 0x10,
    0x05, 0x21, 0x09, 0x20, 0x07, 0x41, 0xfb, 0xc3, 0xe4, 0x00, 0x6a, 0x10, 0x05, 0x21, 0x0a, 0x41,
    0x00, 0x21, 0x0b, 0x41, 0x00, 0x21, 0x0c, 0x03, 0x40, 0x20, 0x09, 0x41, 0xed, 0xfc, 0x01, 0x6c,
    0x20, 0x0a, 0x41, 0xfa, 0x57, 0x6c, 0x6a, 0x22, 0x07, 0x20, 0x07, 0x41, 0x1f, 0x75, 0x6a, 0x41,
    0x80, 0x80, 0x01, 0x6a, 0x41, 0x0f, 0x75, 0x21, 0x0d, 0x20, 0x05, 0x21, 0x07, 0x20, 0x06, 0x21,
    0x0e, 0x20, 0x09, 0x21, 0x0f, 0x41, 0x00, 0x21, 0x10, 0x03, 0x40, 0x20, 0x0b, 0x20, 0x10, 0x6a,
    0x20, 0x02, 0x20, 0x03, 0x41, 0x00, 0x20, 0x0f, 0x20, 0x00, 0x6a, 0x20, 0x07, 0x6a, 0x22, 0x11,
    0x6b, 0x20, 0x11, 0x20, 0x01, 0x1b, 0x41, 0x80, 0x80, 0x06, 0x6a, 0x22, 0x11, 0x41, 0x00, 0x20,
    0x11, 0x41, 0x00, 0x4a, 0x1b, 0x22, 0x11, 0x41, 0x80, 0x80, 0x0c, 0x20, 0x11, 0x41, 0x80, 0x80,
    0x0c, 0x48, 0x1b, 0x41, 0xd5, 0x00, 0x6c, 0x41, 0x10, 0x76, 0x41, 0x00, 0x20, 0x0f, 0x41, 0xda,
    0xf9, 0x03, 0x6c, 0x22, 0x11, 0x20, 0x11, 0x41, 0x1f, 0x75, 0x6a, 0x41, 0x80, 0x80, 0x01, 0x6a,
    0x41, 0x0f, 0x75, 0x20, 0x0d, 0x6b, 0x22, 0x0d, 0x20, 0x00, 0x6a, 0x20, 0x07, 0x41, 0xee, 0xf1,
    0x03, 0x6c, 0x22, 0x11, 0x20, 0x11, 0x41, 0x1f, 0x75, 0x6a, 0x41, 0x80, 0x80, 0x01, 0x6a, 0x41,
    0x0f, 0x75, 0x20, 0x0e, 0x6b, 0x22, 0x0e, 0x6a, 0x22, 0x11, 0x6b, 0x20, 0x11, 0x20, 0x01, 0x1b,
    0x41, 0x80, 0x80, 0x06, 0x6a, 0x22, 0x11, 0x41, 0x00, 0x20, 0x11, 0x41, 0x00, 0x4a, 0x1b, 0x22,
    0x11, 0x41, 0x80, 0x80, 0x0c, 0x20, 0x11, 0x41, 0x80, 0x80, 0x0c, 0x48, 0x1b, 0x41, 0xd5, 0x00,
    0x6c, 0x41, 0x10, 0x76, 0x41, 0x00, 0x20, 0x0d, 0x41, 0xda, 0xf9, 0x03, 0x6c, 0x22, 0x11, 0x20,
    0x11, 0x41, 0x1f, 0x75, 0x6a, 0x41, 0x80, 0x80, 0x01, 0x6a, 0x41, 0x0f, 0x75, 0x20, 0x0f, 0x6b,
    0x22, 0x0f, 0x20, 0x00, 0x6a, 0x20, 0x0e, 0x41, 0xee, 0xf1, 0x03, 0x6c, 0x22, 0x11, 0x20, 0x11,
    0x41, 0x1f, 0x75, 0x6a, 0x41, 0x80, 0x80, 0x01, 0x6a, 0x41, 0x0f, 0x75, 0x20, 0x07, 0x6b, 0x22,
    0x07, 0x6a, 0x22, 0x11, 0x6b, 0x20, 0x11, 0x20, 0x01, 0x1b, 0x41, 0x80, 0x80, 0x06, 0x6a, 0x22,
    0x11, 0x41, 0x00, 0x20, 0x11, 0x41, 0x00, 0x4a, 0x1b, 0x22, 0x11, 0x41, 0x80, 0x80, 0x0c, 0x20,
    0x11, 0x41, 0x80, 0x80, 0x0c, 0x48, 0x1b, 0x41, 0xd5, 0x00, 0x6c, 0x41, 0x10, 0x76, 0x41, 0x00,
    0x20, 0x0f, 0x41, 0xda, 0xf9, 0x03, 0x6c, 0x22, 0x11, 0x20, 0x11, 0x41, 0x1f, 0x75, 0x6a, 0x41,
    0x80, 0x80, 0x01, 0x6a, 0x41, 0x0f, 0x75, 0x20, 0x0d, 0x6b, 0x22, 0x0d, 0x20, 0x00, 0x6a, 0x20,
    0x07, 0x41, 0xee, 0xf1, 0x03, 0x6c, 0x22, 0x11, 0x20, 0x11, 0x41, 0x1f, 0x75, 0x6a, 0x41, 0x80,
    0x80, 0x01, 0x6a, 0x41, 0x0f, 0x75, 0x20, 0x0e, 0x6b, 0x22, 0x0e, 0x6a, 0x22, 0x11, 0x6b, 0x20,
    0x11, 0x20, 0x01, 0x1b, 0x41, 0x80, 0x80, 0x06, 0x6a, 0x22, 0x11, 0x41, 0x00, 0x20, 0x11, 0x41,
    0x00, 0x4a, 0x1b, 0x22, 0x11, 0x41, 0x80, 0x80, 0x0c, 0x20, 0x11, 0x41, 0x80, 0x80, 0x0c, 0x48,
    0x1b, 0x41, 0xd5, 0x00, 0x6c, 0x41, 0x10, 0x76, 0x41, 0x00, 0x20, 0x0d, 0x41, 0xda, 0xf9, 0x03,
    0x6c, 0x22, 0x11, 0x20, 0x11, 0x41, 0x1f, 0x75, 0x6a, 0x41, 0x80, 0x80, 0x01, 0x6a, 0x41, 0x0f,
    0x75, 0x20, 0x0f, 0x6b, 0x22, 0x0f, 0x20, 0x00, 0x6a, 0x20, 0x0e, 0x41, 0xee, 0xf1, 0x03, 0x6c,
    0x22, 0x11, 0x20, 0x11, 0x41, 0x1f, 0x75, 0x6a, 0x41, 0x80, 0x80, 0x01, 0x6a, 0x41, 0x0f, 0x75,
    0x20, 0x07, 0x6b, 0x22, 0x07, 0x6a, 0x22, 0x11, 0x6b, 0x20, 0x11, 0x20, 0x01, 0x1b, 0x41, 0x80,
    0x80, 0x06, 0x6a, 0x22, 0x11, 0x41, 0x00, 0x20, 0x11, 0x41, 0x00, 0x4a, 0x1b, 0x22, 0x11, 0x41,
    0x80, 0x80, 0x0c, 0x20, 0x11, 0x41, 0x80, 0x80, 0x0c, 0x48, 0x1b, 0x41, 0xd5, 0x00, 0x6c, 0x41,
    0x10, 0x76, 0x41, 0x00, 0x20, 0x0f, 0x41, 0xda, 0xf9, 0x03, 0x6c, 0x22, 0x11, 0x20, 0x11, 0x41,
    0x1f, 0x75, 0x6a, 0x41, 0x80, 0x80, 0x01, 0x6a, 0x41, 0x0f, 0x75, 0x20, 0x0d, 0x6b, 0x22, 0x0d,
    0x20, 0x00, 0x6a, 0x20, 0x07, 0x41, 0xee, 0xf1, 0x03, 0x6c, 0x22, 0x11, 0x20, 0x11, 0x41, 0x1f,
    0x75, 0x6a, 0x41, 0x80, 0x80, 0x01, 0x6a, 0x41, 0x0f, 0x75, 0x20, 0x0e, 0x6b, 0x22, 0x0e, 0x6a,
    0x22, 0x11, 0x6b, 0x20, 0x11, 0x20, 0x01, 0x1b, 0x41, 0x80, 0x80, 0x06, 0x6a, 0x22, 0x11, 0x41,
    0x00, 0x20, 0x11, 0x41, 0x00, 0x4a, 0x1b, 0x22, 0x11, 0x41, 0x80, 0x80, 0x0c, 0x20, 0x11, 0x41,
    0x80, 0x80, 0x0c, 0x48, 0x1b, 0x41, 0xd5, 0x00, 0x6c, 0x41, 0x10, 0x76, 0x41, 0x00, 0x20, 0x0d,
    0x41, 0xda, 0xf9, 0x03, 0x6c, 0x22, 0x11, 0x20, 0x11, 0x41, 0x1f, 0x75, 0x6a, 0x41, 0x80, 0x80,
    0x01, 0x6a, 0x41, 0x0f, 0x75, 0x20, 0x0f, 0x6b, 0x22, 0x0f, 0x20, 0x00, 0x6a, 0x20, 0x0e, 0x41,
    0xee, 0xf1, 0x03, 0x6c, 0x22, 0x11, 0x20, 0x11, 0x41, 0x1f, 0x75, 0x6a, 0x41, 0x80, 0x80, 0x01,
    0x6a, 0x41, 0x0f, 0x75, 0x20, 0x07, 0x6b, 0x22, 0x07, 0x6a, 0x22, 0x11, 0x6b, 0x20, 0x11, 0x20,
    0x01, 0x1b, 0x41, 0x80, 0x80, 0x06, 0x6a, 0x22, 0x11, 0x41, 0x00, 0x20, 0x11, 0x41, 0x00, 0x4a,
    0x1b, 0x22, 0x11, 0x41, 0x80, 0x80, 0x0c, 0x20, 0x11, 0x41, 0x80, 0x80, 0x0c, 0x48, 0x1b, 0x41,
    0xd5, 0x00, 0x6c, 0x41, 0x10, 0x76, 0x41, 0x00, 0x20, 0x0f, 0x41, 0xda, 0xf9, 0x03, 0x6c, 0x22,
    0x11, 0x20, 0x11, 0x41, 0x1f, 0x75, 0x6a, 0x41, 0x80, 0x80, 0x01, 0x6a, 0x41, 0x0f, 0x75, 0x20,
    0x0d, 0x6b, 0x22, 0x0d, 0x20, 0x00, 0x6a, 0x20, 0x07, 0x41, 0xee, 0xf1, 0x03, 0x6c, 0x22, 0x11,
    0x20, 0x11, 0x41, 0x1f, 0x75, 0x6a, 0x41, 0x80, 0x80, 0x01, 0x6a, 0x41, 0x0f, 0x75, 0x20, 0x0e,
    0x6b, 0x22, 0x0e, 0x6a, 0x22, 0x11, 0x6b, 0x20, 0x11, 0x20, 0x01, 0x1b, 0x41, 0x80, 0x80, 0x06,
    0x6a, 0x22, 0x11, 0x41, 0x00, 0x20, 0x11, 0x41, 0x00, 0x4a, 0x1b, 0x22, 0x11, 0x41, 0x80, 0x80,
    0x0c, 0x20, 0x11, 0x41, 0x80, 0x80, 0x0c, 0x48, 0x1b, 0x41, 0xd5, 0x00, 0x6c, 0x41, 0x10, 0x76,
    0x10, 0x01, 0x20, 0x0d, 0x41, 0xda, 0xf9, 0x03, 0x6c, 0x22, 0x11, 0x20, 0x11, 0x41, 0x1f, 0x75,
    0x6a, 0x41, 0x80, 0x80, 0x01, 0x6a, 0x41, 0x0f, 0x75, 0x20, 0x0f, 0x6b, 0x21, 0x0f, 0x20, 0x0e,
    0x41, 0xee, 0xf1, 0x03, 0x6c, 0x22, 0x11, 0x20, 0x11, 0x41, 0x1f, 0x75, 0x6a, 0x41, 0x80, 0x80,
    0x01, 0x6a, 0x41, 0x0f, 0x75, 0x20, 0x07, 0x6b, 0x21, 0x07, 0x20, 0x10, 0x41, 0x20, 0x49, 0x21,
    0x11, 0x20, 0x10, 0x41, 0x08, 0x6a, 0x22, 0x12, 0x21, 0x10, 0x20, 0x11, 0x0d, 0x00, 0x0b, 0x20,
    0x09, 0x41, 0x0e, 0x74, 0x21, 0x07, 0x20, 0x09, 0x41, 0xda, 0xdd, 0x01, 0x6c, 0x20, 0x0a, 0x41,
    0x0e, 0x74, 0x6a, 0x22, 0x0f, 0x20, 0x0f, 0x41, 0x1f, 0x75, 0x6a, 0x41, 0x80, 0x80, 0x01, 0x6a,
    0x41, 0x0f, 0x75, 0x21, 0x09, 0x20, 0x00, 0x41, 0x0e, 0x74, 0x21, 0x0f, 0x20, 0x00, 0x41, 0xda,
    0xdd, 0x01, 0x6c, 0x20, 0x08, 0x41, 0x0e, 0x74, 0x6a, 0x22, 0x00, 0x20, 0x00, 0x41, 0x1f, 0x75,
    0x6a, 0x41, 0x80, 0x80, 0x01, 0x6a, 0x41, 0x0f, 0x75, 0x21, 0x00, 0x20, 0x0b, 0x20, 0x12, 0x6a,
    0x21, 0x0b, 0x20, 0x08, 0x41, 0xda, 0xdd, 0x01, 0x6c, 0x20, 0x0f, 0x6b, 0x22, 0x0f, 0x20, 0x0f,
    0x41, 0x1f, 0x75, 0x6a, 0x41, 0x80, 0x80, 0x01, 0x6a, 0x41, 0x0f, 0x75, 0x21, 0x08, 0x20, 0x0a,
    0x41, 0xda, 0xdd, 0x01, 0x6c, 0x20, 0x07, 0x6b, 0x22, 0x07, 0x20, 0x07, 0x41, 0x1f, 0x75, 0x6a,
    0x41, 0x80, 0x80, 0x01, 0x6a, 0x41, 0x0f, 0x75, 0x21, 0x0a, 0x20, 0x0c, 0x41, 0x01, 0x6a, 0x22,
    0x0c, 0x41, 0x0c, 0x47, 0x0d, 0x00, 0x0b, 0x0b, 0x04, 0x00, 0x23, 0x01, 0x0b, 0xa0, 0x03, 0x01,
    0x03, 0x7e, 0x41, 0xf7, 0x87, 0xc9, 0x01, 0x20, 0x00, 0x41, 0xed, 0x8f, 0x92, 0x03, 0x70, 0x22,
    0x00, 0x41, 0x93, 0xf0, 0xed, 0x7c, 0x6a, 0x20, 0x00, 0x20, 0x00, 0x41, 0xf7, 0x87, 0xc9, 0x01,
    0x4b, 0x1b, 0x22, 0x00, 0x6b, 0x41, 0x89, 0xf8, 0xb6, 0x7e, 0x20, 0x00, 0x6b, 0x20, 0x00, 0x20,
    0x00, 0x41, 0x85, 0xbc, 0x9b, 0x7f, 0x48, 0x1b, 0x20, 0x00, 0x41, 0xfb, 0xc3, 0xe4, 0x00, 0x4a,
    0x1b, 0xac, 0x22, 0x01, 0x20, 0x01, 0x7e, 0x42, 0x0c, 0x86, 0x42, 0x80, 0x80, 0x80, 0x80, 0x08,
    0x7c, 0x42, 0x20, 0x87, 0x22, 0x02, 0x42, 0x8f, 0x17, 0x7e, 0x21, 0x03, 0x02, 0x40, 0x02, 0x40,
    0x20, 0x02, 0x42, 0x00, 0x53, 0x0d, 0x00, 0x20, 0x03, 0x42, 0x80, 0x80, 0x20, 0x7c, 0x42, 0x14,
    0x88, 0x21, 0x03, 0x0c, 0x01, 0x0b, 0x42, 0x00, 0x42, 0x80, 0x80, 0x20, 0x20, 0x03, 0x7d, 0x42,
    0x14, 0x88, 0x7d, 0x21, 0x03, 0x0b, 0x02, 0x40, 0x02, 0x40, 0x20, 0x03, 0x42, 0x20, 0x86, 0x42,
    0x80, 0x80, 0x80, 0x80, 0xc0, 0xf9, 0xaf, 0x7e, 0x7c, 0x42, 0x20, 0x87, 0x20, 0x02, 0x7e, 0x22,
    0x03, 0x42, 0x00, 0x53, 0x0d, 0x00, 0x20, 0x03, 0x42, 0x80, 0x80, 0x20, 0x7c, 0x42, 0x14, 0x88,
    0x21, 0x03, 0x0c, 0x01, 0x0b, 0x42, 0x00, 0x42, 0x80, 0x80, 0x20, 0x20, 0x03, 0x7d, 0x42, 0x14,
    0x88, 0x7d, 0x21, 0x03, 0x0b, 0x02, 0x40, 0x02, 0x40, 0x20, 0x03, 0x42, 0x20, 0x86, 0x42, 0x80,
    0x80, 0x80, 0x80, 0x90, 0x91, 0xa2, 0xc4, 0x00, 0x7c, 0x42, 0x20, 0x87, 0x20, 0x02, 0x7e, 0x22,
    0x03, 0x42, 0x00, 0x53, 0x0d, 0x00, 0x20, 0x03, 0x42, 0x80, 0x80, 0x20, 0x7c, 0x42, 0x14, 0x88,
    0x21, 0x03, 0x0c, 0x01, 0x0b, 0x42, 0x00, 0x42, 0x80, 0x80, 0x20, 0x20, 0x03, 0x7d, 0x42, 0x14,
    0x88, 0x7d, 0x21, 0x03, 0x0b, 0x02, 0x40, 0x02, 0x40, 0x20, 0x03, 0x42, 0x20, 0x86, 0x42, 0x80,
    0x80, 0x80, 0x80, 0xd0, 0xaa, 0xd5, 0xaa, 0x75, 0x7c, 0x42, 0x20, 0x87, 0x20, 0x02, 0x7e, 0x22,
    0x02, 0x42, 0x00, 0x53, 0x0d, 0x00, 0x20, 0x02, 0x42, 0x80, 0x80, 0x20, 0x7c, 0x42, 0x14, 0x88,
    0x21, 0x02, 0x0c, 0x01, 0x0b, 0x42, 0x00, 0x42, 0x80, 0x80, 0x20, 0x20, 0x02, 0x7d, 0x42, 0x14,
    0x88, 0x7d, 0x21, 0x02, 0x0b, 0x02, 0x40, 0x20, 0x02, 0x42, 0x20, 0x86, 0x42, 0x80, 0x80, 0x80,
    0x80, 0x80, 0x80, 0x80, 0x80, 0xc0, 0x00, 0x7c, 0x42, 0x20, 0x87, 0x20, 0x01, 0x7e, 0x22, 0x02,
    0x42, 0x00, 0x53, 0x0d, 0x00, 0x20, 0x02, 0x42, 0x80, 0x80, 0x80, 0x80, 0x02, 0x7c, 0x42, 0x1e,
    0x88, 0x42, 0x10, 0x7c, 0x42, 0x05, 0x88, 0xa7, 0x0f, 0x0b, 0x02, 0x40, 0x42, 0x80, 0x80, 0x80,
    0x80, 0x02, 0x20, 0x02, 0x7d, 0x42, 0x1e, 0x88, 0x22, 0x02, 0x50, 0x45, 0x0d, 0x00, 0x41, 0x00,
    0x0f, 0x0b, 0x41, 0x00, 0x20, 0x02, 0x42, 0x10, 0x7c, 0x42, 0x05, 0x88, 0xa7, 0x6b, 0x0b,
};
```

## src/wasm3_security_modules.h
```c
#pragma once

#include <stddef.h>
#include <stdint.h>

/*
 * Small checked-in Wasm binaries for interpreter security regressions. They
 * are encoded directly so neither firmware nor host CI needs a WAT toolchain.
 */

/*
 * rgbx_tick recursively calls a one-argument function whose frame also calls
 * a three-argument helper. This is the integer-only stack-slot reproducer from
 * wasm3 issue #562, adapted to the rgbx_mvp.fill admission profile.
 */
static const uint8_t kWasm3RecursiveArgumentsModule[] = {
    0x00, 0x61, 0x73, 0x6d, 0x01, 0x00, 0x00, 0x00,
    0x01, 0x11, 0x03,
    0x60, 0x01, 0x7f, 0x00,
    0x60, 0x03, 0x7f, 0x7f, 0x7f, 0x01, 0x7f,
    0x60, 0x01, 0x7f, 0x01, 0x7f,
    0x02, 0x11, 0x01, 0x08, 0x72, 0x67, 0x62, 0x78, 0x5f, 0x6d, 0x76, 0x70,
    0x04, 0x66, 0x69, 0x6c, 0x6c, 0x00, 0x00,
    0x03, 0x04, 0x03, 0x01, 0x02, 0x00,
    0x07, 0x0d, 0x01, 0x09, 0x72, 0x67, 0x62, 0x78, 0x5f, 0x74, 0x69, 0x63, 0x6b,
    0x00, 0x03,
    0x0a, 0x24, 0x03,
    0x04, 0x00, 0x20, 0x00, 0x0b,
    0x11, 0x01, 0x01, 0x7f, 0x20, 0x01, 0x20, 0x01, 0x41, 0x00, 0x10, 0x01, 0x1a,
    0x20, 0x01, 0x10, 0x02, 0x0b,
    0x0b, 0x00, 0x20, 0x00, 0x10, 0x02, 0x1a, 0x41, 0x00, 0x10, 0x00, 0x0b,
};

/* Exact integer-only module from wasm3 issue #562, for the native sanitizer. */
static const uint8_t kWasm3Issue562Module[] = {
    0x00, 0x61, 0x73, 0x6d, 0x01, 0x00, 0x00, 0x00,
    0x01, 0x11, 0x03,
    0x60, 0x03, 0x7f, 0x7f, 0x7f, 0x01, 0x7f,
    0x60, 0x01, 0x7f, 0x01, 0x7f,
    0x60, 0x00, 0x01, 0x7f,
    0x03, 0x04, 0x03, 0x00, 0x01, 0x02,
    0x07, 0x08, 0x01, 0x04, 0x6d, 0x61, 0x69, 0x6e, 0x00, 0x02,
    0x0a, 0x24, 0x03,
    0x04, 0x00, 0x20, 0x00, 0x0b,
    0x11, 0x01, 0x01, 0x7f, 0x20, 0x01, 0x20, 0x01, 0x41, 0x00, 0x10, 0x00, 0x1a,
    0x20, 0x01, 0x10, 0x01, 0x0b,
    0x0b, 0x01, 0x01, 0x7f, 0x41, 0x00, 0x10, 0x01, 0x1a, 0x41, 0x00, 0x0b,
};

/*
 * br_table targetCount is UINT32_MAX - 3. Adding the four code lines required
 * by the compiler used to wrap to zero (wasm3 issue #570).
 */
static const uint8_t kWasm3BranchTableOverflowModule[] = {
    0x00, 0x61, 0x73, 0x6d, 0x01, 0x00, 0x00, 0x00,
    0x01, 0x05, 0x01, 0x60, 0x01, 0x7f, 0x00,
    0x02, 0x11, 0x01, 0x08, 0x72, 0x67, 0x62, 0x78, 0x5f, 0x6d, 0x76, 0x70,
    0x04, 0x66, 0x69, 0x6c, 0x6c, 0x00, 0x00,
    0x03, 0x02, 0x01, 0x00,
    0x07, 0x0d, 0x01, 0x09, 0x72, 0x67, 0x62, 0x78, 0x5f, 0x74, 0x69, 0x63, 0x6b,
    0x00, 0x01,
    0x0a, 0x0f, 0x01, 0x0d, 0x00, 0x02, 0x40, 0x20, 0x00, 0x0e,
    0xfc, 0xff, 0xff, 0xff, 0x0f, 0x0b, 0x0b,
};

/*
 * A declared memory followed by a data segment whose UINT32_MAX byte payload
 * is absent. Pointer addition before a bounds check overflowed on 32-bit hosts
 * (wasm3 issue #555).
 */
static const uint8_t kWasm3DataSegmentOverflowModule[] = {
    0x00, 0x61, 0x73, 0x6d, 0x01, 0x00, 0x00, 0x00,
    0x05, 0x03, 0x01, 0x00, 0x01,
    0x0b, 0x0a, 0x01, 0x00, 0x41, 0x00, 0x0b, 0xff, 0xff, 0xff, 0xff, 0x0f,
};
```
