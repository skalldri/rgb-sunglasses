## CMakeLists.txt
```
# SPDX-License-Identifier: Apache-2.0

cmake_minimum_required(VERSION 3.20.0)
find_package(Zephyr REQUIRED HINTS $ENV{ZEPHYR_BASE})
project(rgbx_package_tests)

set(FW_ROOT ${CMAKE_CURRENT_LIST_DIR}/../../..)

target_sources(app PRIVATE
  src/main.cpp
  ${FW_ROOT}/src/extensions/rgbx_package.cpp
  ${FW_ROOT}/src/extensions/rgbx_package_psa.cpp
  ${FW_ROOT}/src/extensions/rgbx_staged_package.cpp
)

target_include_directories(app PRIVATE ${FW_ROOT}/src ${FW_ROOT}/include)

# The release-package test asserts the parsed source digest equals the SHA-256
# of the exact source the SDK consumer compiled into that package. Compute it
# from the committed source at build time so the expectation cannot drift from
# the source, and hand it to the test as a hex string.
set(_rgbx_v2_test_source ${FW_ROOT}/sdk/tests/consumer/rgbx_v2_test.c)
file(SHA256 ${_rgbx_v2_test_source} _rgbx_v2_test_source_sha256)
target_compile_definitions(app PRIVATE
  RGBX_V2_TEST_SOURCE_SHA256="${_rgbx_v2_test_source_sha256}")
```

## prj.conf
```kconfig
CONFIG_ZTEST=y
CONFIG_ZTEST_STACK_SIZE=16384
CONFIG_CPP=y
CONFIG_STD_CPP2B=y
CONFIG_REQUIRES_FULL_LIBCPP=y
CONFIG_REQUIRES_FULL_LIBC=y
CONFIG_ZCBOR=y
CONFIG_ZCBOR_CANONICAL=y
CONFIG_MBEDTLS=y
CONFIG_MBEDTLS_PSA_CRYPTO_C=y
CONFIG_PSA_WANT_ALG_SHA_256=y
```

## src/rgbx_v2_test_package.h
```c
#pragma once

#include <cstddef>
#include <cstdint>

// SPDX-License-Identifier: MIT
// Copyright (c) 2026 Stuart Alldritt
// Full permission notice: fw/sdk/LICENSE.
// Generated by the release-pinned RGBX v2 SDK consumer build.
// SHA-256: 74641026f574796858a40364bd5b3322d3584b2fe93fe0d89f7a1e5b841add5c.
inline constexpr uint8_t kRgbxV2TestPackage[] = {
    0x52, 0x47, 0x42, 0x58, 0x01, 0x00, 0x14, 0x00, 0x6d, 0x00, 0x00, 0x00, 0xdb, 0x00, 0x00, 0x00,
    0x00, 0x00, 0x00, 0x00, 0x8f, 0x01, 0x6c, 0x72, 0x67, 0x62, 0x78, 0x5f, 0x76, 0x32, 0x5f, 0x74,
    0x65, 0x73, 0x74, 0x70, 0x52, 0x47, 0x42, 0x58, 0x20, 0x76, 0x32, 0x20, 0x53, 0x44, 0x4b, 0x20,
    0x54, 0x65, 0x73, 0x74, 0x83, 0x00, 0x00, 0x00, 0x02, 0x01, 0x82, 0x18, 0x28, 0x0c, 0x01, 0x00,
    0x00, 0x61, 0x63, 0x68, 0x77, 0x61, 0x73, 0x69, 0x2d, 0x73, 0x64, 0x6b, 0x64, 0x33, 0x33, 0x2e,
    0x30, 0x58, 0x20, 0xf9, 0x09, 0x0e, 0x85, 0xe3, 0x6c, 0x99, 0x83, 0xed, 0x62, 0xf3, 0xe8, 0xea,
    0xb8, 0xb3, 0x6c, 0x03, 0xad, 0x12, 0xb4, 0xc8, 0x99, 0x27, 0xe4, 0x56, 0x25, 0x47, 0x85, 0x1d,
    0xac, 0x27, 0xe7, 0x81, 0x83, 0x01, 0x65, 0x43, 0x6f, 0x6c, 0x6f, 0x72, 0x1a, 0x00, 0xff, 0x00,
    0xff, 0x00, 0x61, 0x73, 0x6d, 0x01, 0x00, 0x00, 0x00, 0x01, 0x1f, 0x05, 0x60, 0x02, 0x7f, 0x7f,
    0x01, 0x7f, 0x60, 0x01, 0x7f, 0x01, 0x7f, 0x60, 0x09, 0x7f, 0x7f, 0x7f, 0x7f, 0x7f, 0x7f, 0x7f,
    0x7f, 0x7f, 0x00, 0x60, 0x00, 0x00, 0x60, 0x01, 0x7f, 0x00, 0x02, 0x3d, 0x03, 0x07, 0x72, 0x67,
    0x62, 0x78, 0x5f, 0x76, 0x32, 0x09, 0x69, 0x6e, 0x70, 0x75, 0x74, 0x5f, 0x75, 0x33, 0x32, 0x00,
    0x00, 0x07, 0x72, 0x67, 0x62, 0x78, 0x5f, 0x76, 0x32, 0x09, 0x70, 0x61, 0x72, 0x61, 0x6d, 0x5f,
    0x75, 0x33, 0x32, 0x00, 0x01, 0x07, 0x72, 0x67, 0x62, 0x78, 0x5f, 0x76, 0x32, 0x09, 0x73, 0x65,
    0x74, 0x5f, 0x73, 0x70, 0x61, 0x6e, 0x38, 0x00, 0x02, 0x03, 0x03, 0x02, 0x03, 0x04, 0x06, 0x08,
    0x01, 0x7f, 0x01, 0x41, 0x80, 0x80, 0x04, 0x0b, 0x07, 0x19, 0x02, 0x09, 0x72, 0x67, 0x62, 0x78,
    0x5f, 0x69, 0x6e, 0x69, 0x74, 0x00, 0x03, 0x09, 0x72, 0x67, 0x62, 0x78, 0x5f, 0x74, 0x69, 0x63,
    0x6b, 0x00, 0x04, 0x0a, 0x47, 0x02, 0x02, 0x00, 0x0b, 0x42, 0x01, 0x01, 0x7f, 0x41, 0x03, 0x41,
    0x00, 0x10, 0x00, 0x20, 0x00, 0x73, 0x41, 0x00, 0x10, 0x01, 0x73, 0x41, 0xff, 0xff, 0xff, 0x07,
    0x71, 0x21, 0x00, 0x41, 0x78, 0x21, 0x01, 0x03, 0x40, 0x20, 0x01, 0x41, 0x08, 0x6a, 0x22, 0x01,
    0x20, 0x00, 0x20, 0x00, 0x20, 0x00, 0x20, 0x00, 0x20, 0x00, 0x20, 0x00, 0x20, 0x00, 0x20, 0x00,
    0x10, 0x02, 0x20, 0x01, 0x41, 0xd8, 0x03, 0x49, 0x0d, 0x00, 0x0b, 0x0b, 0xbb, 0x22, 0x61, 0x90,
    0x1c, 0x01, 0xc5, 0x9f, 0x21, 0xcb, 0x32, 0x96, 0x8e, 0xe8, 0xca, 0x42, 0x77, 0x8f, 0x53, 0x97,
    0xcf, 0x6a, 0x04, 0x98, 0x49, 0x15, 0x83, 0x9b, 0xc1, 0xb6, 0xbe, 0x8f,
};
```
