/*
 * RAM disk for nyan_cat_animation filesystem tests.
 * Mounted at /NAND: to match the hardcoded path in nyan_cat_animation.cpp.
 */
/ {
	nand_ramdisk: ramdisk0 {
		compatible = "zephyr,ram-disk";
		disk-name = "NAND";
		sector-size = <512>;
		sector-count = <256>;
	};
};
