## fw/tests/animations/pulse_animation_di/testcase.yaml
```yaml
tests:
  animations.pulse_animation_di:
    platform_allow:
      - native_sim
    integration_platforms:
      - native_sim
```

## fw/tests/animations/tilt_animation_di/testcase.yaml
```yaml
tests:
  animations.tilt_animation_di:
    platform_allow:
      - native_sim
    integration_platforms:
      - native_sim
```

## fw/tests/animations/zigzag_animation_di/testcase.yaml
```yaml
tests:
  animations.zigzag_animation_di:
    platform_allow:
      - native_sim
    integration_platforms:
      - native_sim
```

## fw/tests/bluetooth/animation_adapters/testcase.yaml
```yaml
tests:
  bluetooth.animation_adapters:
    platform_allow:
      - native_sim
    integration_platforms:
      - native_sim
```

## fw/tests/bluetooth/battery_service/testcase.yaml
```yaml
tests:
  bluetooth.battery_service:
    platform_allow:
      - native_sim
    integration_platforms:
      - native_sim
```

## fw/tests/bluetooth/checked_write/testcase.yaml
```yaml
tests:
  bluetooth.checked_write:
    platform_allow:
      - native_sim
    integration_platforms:
      - native_sim
```

## fw/tests/bluetooth/conn_param_governor/testcase.yaml
```yaml
tests:
  bluetooth.conn_param_governor:
    platform_allow:
      - native_sim
    integration_platforms:
      - native_sim
    tags: bluetooth power
```

## fw/tests/bluetooth/extension_bt/testcase.yaml
```yaml
tests:
  bluetooth.extension_bt:
    platform_allow:
      - native_sim
    integration_platforms:
      - native_sim
```

## fw/tests/bluetooth/gatt_notify_traits/testcase.yaml
```yaml
tests:
  bluetooth.gatt_notify_traits:
    platform_allow:
      - native_sim
    integration_platforms:
      - native_sim
```

## fw/tests/bt_state_observer/testcase.yaml
```yaml
tests:
  interfaces.bt_state_observer:
    tags: interfaces
    integration_platforms:
      - native_sim
```

## fw/tests/debug/coredump_manager/testcase.yaml
```yaml
tests:
  debug.coredump_manager:
    platform_allow:
      - native_sim
    integration_platforms:
      - native_sim
    tags: debug coredump
```

## fw/tests/drivers/bq25792_decode/testcase.yaml
```yaml
tests:
  drivers.bq25792_decode:
    platform_allow:
      - native_sim
    integration_platforms:
      - native_sim
```

## fw/tests/drivers/emul_bmi270/testcase.yaml
```yaml
tests:
  drivers.emul_bmi270:
    platform_allow:
      - native_sim
    integration_platforms:
      - native_sim
  drivers.emul_bmi270.trigger:
    platform_allow:
      - native_sim
    integration_platforms:
      - native_sim
    extra_configs:
      - CONFIG_BMI270_TRIGGER_OWN_THREAD=y
```

## fw/tests/drivers/emul_tps25750/testcase.yaml
```yaml
tests:
  drivers.emul_tps25750:
    platform_allow:
      - native_sim
    integration_platforms:
      - native_sim
  # Same suite, but the emulated part boots in PTCH mode and the driver is
  # built with the internal (uncompressed) patch, so tps25750_init performs
  # the full PBMs -> chunked upload -> PBMc download during boot; the
  # patch_download test asserts the recorded outcome (and self-skips in the
  # default scenario above).
  drivers.emul_tps25750.patch_download:
    platform_allow:
      - native_sim
    integration_platforms:
      - native_sim
    extra_configs:
      - CONFIG_TPS25750_INTERNAL_PATCH=y
      - CONFIG_TPS25750_PATCH_HEADER_FILE="tps25750/tps25750-config-uncompressed.h"
      - CONFIG_EMUL_TPS25750_BOOT_MODE_PTCH=y
```

## fw/tests/extensions/metadata_blob/testcase.yaml
```yaml
tests:
  extensions.metadata_blob:
    platform_allow:
      - native_sim
    integration_platforms:
      - native_sim
```

## fw/tests/extensions/param_persistence/testcase.yaml
```yaml
tests:
  extensions.param_persistence:
    platform_allow:
      - native_sim
    integration_platforms:
      - native_sim
```

## fw/tests/factory_reset/testcase.yaml
```yaml
tests:
  factory_reset.core:
    platform_allow:
      - native_sim
    integration_platforms:
      - native_sim
    tags: factory_reset
```

## fw/tests/fonts/font_atlas/testcase.yaml
```yaml
tests:
  fonts.font_atlas:
    platform_allow:
      - native_sim
    integration_platforms:
      - native_sim
```

## fw/tests/imu/pipeline/testcase.yaml
```yaml
tests:
  imu.pipeline:
    platform_allow:
      - native_sim
    integration_platforms:
      - native_sim
```

## fw/tests/mcuboot_updater/testcase.yaml
```yaml
tests:
  mcuboot_updater.state_machine:
    platform_allow:
      - native_sim
    integration_platforms:
      - native_sim
    tags: mcuboot updater
    filter: dt_label_with_parent_compat_enabled("mcuboot", "fixed-partitions")
```

## fw/tests/power/battery_soc/testcase.yaml
```yaml
tests:
  power.battery_soc:
    tags: power
    platform_allow:
      - native_sim
    integration_platforms:
      - native_sim
```

## fw/tests/power/charger_policy/testcase.yaml
```yaml
tests:
  power.charger_policy:
    platform_allow:
      - native_sim
    integration_platforms:
      - native_sim
```

## fw/tests/power/comm_health/testcase.yaml
```yaml
tests:
  power.comm_health:
    tags: power
    platform_allow:
      - native_sim
    integration_platforms:
      - native_sim
```

## fw/tests/power/shell/testcase.yaml
```yaml
tests:
  power.shell:
    platform_allow:
      - native_sim
    integration_platforms:
      - native_sim
```
