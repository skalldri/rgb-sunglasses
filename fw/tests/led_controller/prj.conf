## CMakeLists.txt
```
cmake_minimum_required(VERSION 3.20.0)

# Custom DT binding (test,fake-led-strip) lives in this test's dts/bindings —
# DTS_ROOT must be appended BEFORE find_package(Zephyr) or the binding is
# silently not found.
list(APPEND DTS_ROOT ${CMAKE_CURRENT_LIST_DIR})

find_package(Zephyr REQUIRED HINTS $ENV{ZEPHYR_BASE})
project(led_controller_test)

target_sources(app PRIVATE
    src/main.cpp
    src/fake_led_strip.c
    ${CMAKE_CURRENT_LIST_DIR}/../../src/led_controller.cpp
)

# The stub core_config.h in include/ must shadow fw/src's real one (which drags
# in the BT GATT stack) — BEFORE is required for include-path precedence; see
# fw/tests/mcuboot_updater/CMakeLists.txt.
target_include_directories(app BEFORE PRIVATE ${CMAKE_CURRENT_LIST_DIR}/include)
target_include_directories(app PRIVATE ${CMAKE_CURRENT_LIST_DIR}/../../src)
```

## Kconfig
```
source "Kconfig.zephyr"

# led_controller.cpp consumes these app symbols. They're defined in fw/Kconfig, which
# standalone Twister apps don't see — redeclared here with the same names and defaults.
# (Same pattern as fw/tests/imu/pipeline/Kconfig.)
config APP_LED_DISPLAY_THREAD_PRIORITY
	int "LED display thread priority"
	default 2

config APP_LED_DISPLAY_THREAD_STACK_SIZE
	int "LED display thread stack size (bytes)"
	default 4096

# Not used to create a thread here, but led_controller.cpp's ordering BUILD_ASSERT
# compares against it, so the assert is exercised in this suite too.
config APP_PATTERN_CONTROLLER_THREAD_PRIORITY
	int "Pattern controller (render) thread priority"
	default 4

# Gates the per-segment CPU attribution in led_controller.cpp. Declared here (with the
# same default as fw/Kconfig) so the suite compiles the REAL k_thread_runtime_stats
# paths rather than the compiled-out stubs — otherwise display_cpu_cycles()/cpu_split()
# are never built here and the config guards below them are never checked.
config APP_LED_SEGMENT_CPU_ATTRIBUTION
	bool "Per-segment CPU attribution for the display thread"
	default y
	select THREAD_RUNTIME_STATS
	select SCHED_THREAD_USAGE
	select SCHED_THREAD_USAGE_ALL
	select SCHED_THREAD_USAGE_AUTO_ENABLE
```

## prj.conf
```kconfig
CONFIG_ZTEST=y
CONFIG_CPP=y
CONFIG_STD_CPP2B=y
CONFIG_REQUIRES_FULL_LIBCPP=y
CONFIG_REQUIRES_FULL_LIBC=y

# The led_output shell command is part of the unit under test; drive it through
# the dummy backend (shell_execute_cmd) rather than poking internals.
CONFIG_SHELL=y
CONFIG_SHELL_BACKEND_DUMMY=y
# The dummy backend TRUNCATES output past its buffer with no error, and the
# tests strstr the LAST lines of cmd_led_stats's ~8-line output ("held frames:",
# "overruns:"). The default (400 here — LOG_PRINTK bumps it from 300) leaves
# only ~125 B of headroom, and a single verdictText() suffix (+68 chars per
# flagged line) would push those lines off the end and fail the wrong assert
# (PR #381 review round 6). 1024 keeps the whole output comfortably inside.
CONFIG_SHELL_BACKEND_DUMMY_BUF_SIZE=1024

# Per-segment CPU attribution in led_controller.cpp reads the display thread's
# execution_cycles; without this the field does not exist and the unit under test
# refuses to compile (deliberately — see the #error there).
CONFIG_THREAD_RUNTIME_STATS=y
CONFIG_SCHED_THREAD_USAGE=y
```

## boards/native_sim.overlay
```dts
/ {
	/* Same chain lengths as the proto0 panel strips so kFrameLedConfig's
	 * geometry (40x12 over two 216-pixel banks) maps 1:1 in tests. No
	 * led-strip-2 alias on purpose: led_controller.cpp only drives it when
	 * CONFIG_STATUS_LED is disabled AND the alias exists.
	 */
	fake_led_strip_0: fake-led-strip-0 {
		compatible = "test,fake-led-strip";
		chain-length = <216>;
		status = "okay";
	};

	fake_led_strip_1: fake-led-strip-1 {
		compatible = "test,fake-led-strip";
		chain-length = <216>;
		status = "okay";
	};

	aliases {
		led-strip-0 = &fake_led_strip_0;
		led-strip-1 = &fake_led_strip_1;
	};
};
```

## dts/bindings/test,fake-led-strip.yaml
```yaml
description: Fake LED strip for led_controller tests — records update_rgb calls

compatible: "test,fake-led-strip"

include: base.yaml

properties:
  chain-length:
    type: int
    required: true
    description: Number of pixels in the fake strip
```

## include/core_config.h
```c
#pragma once

/*
 * Test stub shadowing fw/src/core_config.h by include-path precedence (the
 * CMakeLists adds this dir with BEFORE). The real CoreConfig is backed by
 * BtGattPersistentCharacteristic members and drags in the whole BT GATT
 * stack, which this suite does not build. led_controller.cpp only needs
 * CoreConfig::getInstance() as the lazy-fallback ConfigurationProvider when
 * no provider was injected.
 */

#include <configuration_provider.h>

class CoreConfig : public ConfigurationProvider {
   public:
    static CoreConfig &getInstance() {
        static CoreConfig instance;
        return instance;
    }

    float getBrightnessFactor() override {
        return 1.0f;
    }

    /* 10 ms = one native_sim tick per display update, so tests only need to
     * sleep a few tens of ms per condition. */
    float getDisplayRateMs() override {
        return 10.0f;
    }

    float getRenderRateMs() override {
        return 10.0f;
    }
};
```

## src/fake_led_strip.c
```c
/*
 * Fake led_strip driver (compatible "test,fake-led-strip"): records every
 * update_rgb call so tests can assert whether — and with what pixel data —
 * the display thread is clocking frames out. Sanctioned mock style (c),
 * a DT-registered device emulator; see /add-fw-test.
 */

#define DT_DRV_COMPAT test_fake_led_strip

#include <string.h>
#include <zephyr/device.h>
#include <zephyr/drivers/led_strip.h>
#include <zephyr/sys/util.h>

#include "fake_led_strip.h"

struct fake_led_strip_config {
    size_t length;
};

struct fake_led_strip_data {
    uint32_t update_count;
    struct led_rgb last_frame[FAKE_LED_STRIP_MAX_PIXELS];
    size_t last_len;
};

static int fake_update_rgb(const struct device *dev, struct led_rgb *pixels, size_t num_pixels) {
    struct fake_led_strip_data *data = dev->data;
    size_t n = MIN(num_pixels, (size_t)FAKE_LED_STRIP_MAX_PIXELS);

    memcpy(data->last_frame, pixels, n * sizeof(struct led_rgb));
    data->last_len = n;
    data->update_count++;
    return 0;
}

static size_t fake_length(const struct device *dev) {
    const struct fake_led_strip_config *config = dev->config;

    return config->length;
}

static const struct led_strip_driver_api fake_led_strip_api = {
    .update_rgb = fake_update_rgb,
    .length     = fake_length,
};

uint32_t fake_led_strip_update_count(const struct device *dev) {
    const struct fake_led_strip_data *data = dev->data;

    return data->update_count;
}

const struct led_rgb *fake_led_strip_last_frame(const struct device *dev, size_t *len) {
    const struct fake_led_strip_data *data = dev->data;

    *len = data->last_len;
    return data->last_frame;
}

void fake_led_strip_reset(const struct device *dev) {
    struct fake_led_strip_data *data = dev->data;

    memset(data, 0, sizeof(*data));
}

#define FAKE_LED_STRIP_DEFINE(inst)                                                       \
    static struct fake_led_strip_data fake_led_strip_data_##inst;                         \
    static const struct fake_led_strip_config fake_led_strip_config_##inst = {            \
        .length = DT_INST_PROP(inst, chain_length),                                       \
    };                                                                                    \
    DEVICE_DT_INST_DEFINE(inst, NULL, NULL, &fake_led_strip_data_##inst,                  \
                          &fake_led_strip_config_##inst, POST_KERNEL,                     \
                          CONFIG_KERNEL_INIT_PRIORITY_DEVICE, &fake_led_strip_api);

DT_INST_FOREACH_STATUS_OKAY(FAKE_LED_STRIP_DEFINE)
```

## src/fake_led_strip.h
```c
#pragma once

#include <zephyr/device.h>
#include <zephyr/drivers/led_strip.h>

/* Must cover the largest chain-length in boards/native_sim.overlay (216). */
#define FAKE_LED_STRIP_MAX_PIXELS 216

#ifdef __cplusplus
extern "C" {
#endif

/* Number of led_strip_update_rgb() calls this fake strip has received. */
uint32_t fake_led_strip_update_count(const struct device *dev);

/* Pixel data from the most recent update; *len is its pixel count (0 if the
 * strip was never updated). The pointer stays valid for the device lifetime. */
const struct led_rgb *fake_led_strip_last_frame(const struct device *dev, size_t *len);

/* Clear the update counter and captured frame. */
void fake_led_strip_reset(const struct device *dev);

#ifdef __cplusplus
}
#endif
```
