/*
 * RAM disk for glim_registry filesystem tests.
 * Mounted at /NAND: to match glim_registry::kDirectory's hardcoded prefix.
 */
/ {
	nand_ramdisk: ramdisk0 {
		compatible = "zephyr,ram-disk";
		disk-name = "NAND";
		sector-size = <512>;
		sector-count = <256>;
	};
};
