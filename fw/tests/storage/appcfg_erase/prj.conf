## CMakeLists.txt
```
# SPDX-License-Identifier: Apache-2.0

cmake_minimum_required(VERSION 3.20.0)
find_package(Zephyr REQUIRED HINTS $ENV{ZEPHYR_BASE})
project(appcfg_erase_tests)

target_sources(app PRIVATE src/main.cpp)
target_sources(app PRIVATE ${CMAKE_CURRENT_LIST_DIR}/../../../src/storage/appcfg_erase.cpp)

target_include_directories(app PRIVATE ${CMAKE_CURRENT_LIST_DIR}/../../../src)
```

## prj.conf
```kconfig
CONFIG_ZTEST=y
CONFIG_CPP=y
CONFIG_STD_CPP2B=y
CONFIG_REQUIRES_FULL_LIBCPP=y
CONFIG_REQUIRES_FULL_LIBC=y
CONFIG_FLASH=y
CONFIG_FLASH_MAP=y
```

## boards/native_sim.overlay
```dts
/*
 * Add a settings_storage partition in native_sim's unused flash space (above
 * the OS partitions that end at 0x100000) so that FIXED_PARTITION_ID(settings_storage)
 * resolves the same way it does on hardware (via pm_static YAML).
 */
&flash0 {
	partitions {
		settings_storage: partition@100000 {
			reg = <0x100000 0x8000>;
		};
	};
};
```

## src/main.cpp
```c
#include <storage/appcfg_erase.h>
#include <zephyr/storage/flash_map.h>
#include <zephyr/ztest.h>
#include <cstring>

ZTEST_SUITE(appcfg_erase_tests, NULL, NULL, NULL, NULL, NULL);

ZTEST(appcfg_erase_tests, test_erase_clears_partition_to_0xff) {
    const struct flash_area *fa;
    zassert_ok(flash_area_open(FIXED_PARTITION_ID(settings_storage), &fa),
               "Failed to open settings_storage");

    // Pre-condition: erase then write a known non-0xFF pattern.
    zassert_ok(flash_area_erase(fa, 0, fa->fa_size), "pre-erase failed");

    uint8_t pattern[64];
    memset(pattern, 0xAA, sizeof(pattern));
    zassert_ok(flash_area_write(fa, 0, pattern, sizeof(pattern)), "write failed");
    flash_area_close(fa);

    // Function under test
    zassert_ok(storage_erase_settings_partition(), "erase should succeed");

    // Post-condition: partition should read as all 0xFF.
    zassert_ok(flash_area_open(FIXED_PARTITION_ID(settings_storage), &fa),
               "re-open after erase failed");
    uint8_t buf[64];
    zassert_ok(flash_area_read(fa, 0, buf, sizeof(buf)), "read after erase failed");
    flash_area_close(fa);

    for (size_t i = 0; i < sizeof(buf); i++) {
        zassert_equal(buf[i], 0xFF,
                      "byte[%zu] = 0x%02X, expected 0xFF after erase", i, buf[i]);
    }
}

ZTEST(appcfg_erase_tests, test_erase_is_idempotent) {
    // Erasing an already-blank partition must succeed with no errors.
    zassert_ok(storage_erase_settings_partition(), "first erase should succeed");
    zassert_ok(storage_erase_settings_partition(), "second erase should also succeed");
}
```
