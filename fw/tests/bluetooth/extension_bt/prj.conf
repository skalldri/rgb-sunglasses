## CMakeLists.txt
```
# SPDX-License-Identifier: Apache-2.0

cmake_minimum_required(VERSION 3.20.0)
find_package(Zephyr REQUIRED HINTS $ENV{ZEPHYR_BASE})
project(extension_bt_tests)

target_sources(app PRIVATE src/main.cpp)

# Unit under test.
target_sources(app PRIVATE ${CMAKE_CURRENT_LIST_DIR}/../../../src/extensions/extension_bt.cpp)

# Real, Zephyr-free support code extension_bt.cpp depends on - no reason to
# fake what's already pure logic (extension_metadata_blob, animation_registry,
# animation_base). extension_host.cpp and pattern_controller.cpp are NOT
# linked here: they pull in llext/FAT/LED-controller/thread machinery this
# suite has no business exercising, so their extension_bt.cpp-visible surface
# is faked in src/main.cpp instead (extension_host namespace functions,
# pattern_controller_change_to_animation/get_current_animation).
target_sources(app PRIVATE ${CMAKE_CURRENT_LIST_DIR}/../../../src/extensions/extension_metadata_blob.cpp)
target_sources(app PRIVATE ${CMAKE_CURRENT_LIST_DIR}/../../../src/animations/animation_registry.cpp)
target_sources(app PRIVATE ${CMAKE_CURRENT_LIST_DIR}/../../../src/animations/animation_base.cpp)

# rgbx/rgbx_api.h (extension ABI header)
add_subdirectory(
    ${CMAKE_CURRENT_LIST_DIR}/../../../include
    ${CMAKE_CURRENT_BINARY_DIR}/app_include
)

target_include_directories(app PRIVATE ${CMAKE_CURRENT_LIST_DIR}/../../../src)

# bt_service_cpp.h trips -Wcomment (known non-blocking warning, see fw/CLAUDE.md)
target_compile_options(app PRIVATE -Wno-error=comment)
```

## Kconfig
```
source "Kconfig.zephyr"

config APP_BT_METADATA_CHARACTERISTIC
	bool "Append a bulk CUD/CPF metadata characteristic to every BtGattServer service"
	default y
	help
	  Mirrors the symbol of the same name in fw/Kconfig - this test compiles
	  extension_bt.cpp directly, outside the main fw application's Kconfig
	  tree, so it needs its own definition to exercise the runtime bulk
	  metadata characteristic path (issue #90 follow-up).
```

## prj.conf
```kconfig
CONFIG_ZTEST=y

# Enable C++ Language Support
CONFIG_CPP=y

# Enable support for C++23
CONFIG_STD_CPP2B=y

# Link against the C++ Standard Library
CONFIG_REQUIRES_FULL_LIBCPP=y

# Link against the C Standard Library
CONFIG_REQUIRES_FULL_LIBC=y

CONFIG_LOG=y

# Real BT host headers/symbols, including CONFIG_BT_GATT_DYNAMIC_DB for the
# bt_gatt_service_register()/unregister() runtime attribute-table path
# extension_bt.cpp uses. bt_enable() is never called in this test, so no HCI
# transport is exercised at runtime (same pattern as tests/bluetooth/battery_service).
CONFIG_BT=y
CONFIG_BT_PERIPHERAL=y
CONFIG_BT_GATT_SERVICE_CHANGED=y
CONFIG_BT_GATT_DYNAMIC_DB=y
```

## src/main.cpp
```c
/*
 * Tests for the runtime extension GATT service assembler
 * (fw/src/extensions/extension_bt.cpp, issue #180), compiled with the real
 * BT host headers + CONFIG_BT_GATT_DYNAMIC_DB on native_sim.
 *
 * extension_host.cpp (llext/FAT-heavy) and pattern_controller.cpp
 * (LED-controller/thread-heavy) are NOT linked here - both are faked below,
 * matching their real headers' declared signatures exactly, so the linker
 * resolves extension_bt.cpp's calls into these fakes instead. Everything
 * else extension_bt.cpp depends on (extension_metadata_blob.cpp,
 * animation_registry.cpp, animation_base.cpp) is Zephyr-free/lightweight
 * enough to compile for real, same rationale as their own native_sim suites.
 *
 * bt_gatt_service_register()/unregister() work without bt_enable() (see
 * gatt.c: the dynamic-db path only checks CONFIG_BT_SETTINGS gating and
 * GATT_INITIALIZED, neither of which this test sets), so the registered
 * attribute table is inspected via the real bt_gatt_foreach_attr_type() API
 * - the same mechanism BT_ATT read/write handling itself uses - rather than
 * reaching into extension_bt.cpp's private BtSlot state.
 */

#include <animations/animation_registry.h>
#include <animations/animation_types.h>
#include <bluetooth/bt_service_cpp.h>
#include <extensions/extension_bt.h>
#include <extensions/extension_host.h>
#include <extensions/extension_metadata_blob.h>
#include <pattern_controller.h>
#include <rgbx/rgbx_api.h>
#include <zephyr/bluetooth/att.h>
#include <zephyr/bluetooth/gatt.h>
#include <zephyr/bluetooth/uuid.h>
#include <zephyr/sys/byteorder.h>
#include <zephyr/ztest.h>

#include <cerrno>
#include <cstring>

/* ---- Fakes standing in for extension_host.cpp -------------------------- */

namespace {

struct FakeSlot {
    bool loaded = false;
    bool faulted = false;
    bool retired = false;
    char name[extension_host::kMaxNameLen] = {};
    Animation animId = Animation::None;
    size_t paramCount = 0;
    extension_host::ParamInfo paramInfo[RGBX_MAX_PARAMS] = {};
    uint32_t paramValues[RGBX_MAX_PARAMS] = {};
    char paramStrings[RGBX_MAX_PARAMS][RGBX_PARAM_STRING_MAX] = {};
    /* Simulates extension_host::paramInfo() returning nullptr for an index
     * that IS within paramCount - the defensive branch read_param/write_param
     * take when info lookup fails despite a valid-looking ParamCtx. */
    bool hideParamInfo[RGBX_MAX_PARAMS] = {};
    /* Include-in-shuffle flag (issue #243), default true like the real host's. */
    bool shuffleInclude = true;
};

FakeSlot sFakeSlots[extension_host::kMaxExtensions];

void reset_fake_slot(size_t slot) {
    sFakeSlots[slot] = FakeSlot{};
    sFakeSlots[slot].animId =
        static_cast<Animation>(extension_host::kAnimationIdBase + slot);
}

void set_param(size_t slot, size_t idx, const char *name, rgbx_param_type type,
              uint32_t defaultValue, const char *defaultStr = nullptr) {
    FakeSlot &fs = sFakeSlots[slot];
    strncpy(fs.paramInfo[idx].name, name, extension_host::kMaxParamNameLen - 1);
    fs.paramInfo[idx].name[extension_host::kMaxParamNameLen - 1] = '\0';
    fs.paramInfo[idx].type = type;
    fs.paramInfo[idx].defaultValue = defaultValue;
    fs.paramInfo[idx].stringSlot = extension_manifest::kNoStringSlot;
    fs.paramValues[idx] = defaultValue;
    if (defaultStr != nullptr) {
        strncpy(fs.paramStrings[idx], defaultStr, RGBX_PARAM_STRING_MAX - 1);
        fs.paramStrings[idx][RGBX_PARAM_STRING_MAX - 1] = '\0';
    }
}

}  // namespace

namespace extension_host {

bool isLoaded(size_t slot) {
    return slot < kMaxExtensions && sFakeSlots[slot].loaded;
}

bool isFaulted(size_t slot) {
    return slot < kMaxExtensions && sFakeSlots[slot].faulted;
}

bool isRetired(size_t slot) {
    return slot < kMaxExtensions && sFakeSlots[slot].retired;
}

const char *name(size_t slot) {
    return sFakeSlots[slot].name;
}

size_t paramCount(size_t slot) {
    return sFakeSlots[slot].paramCount;
}

const ParamInfo *paramInfo(size_t slot, size_t index) {
    if (index >= sFakeSlots[slot].paramCount || sFakeSlots[slot].hideParamInfo[index]) {
        return nullptr;
    }
    return &sFakeSlots[slot].paramInfo[index];
}

uint32_t paramValue(size_t slot, size_t index) {
    return sFakeSlots[slot].paramValues[index];
}

void setParamValue(size_t slot, size_t index, uint32_t value) {
    sFakeSlots[slot].paramValues[index] = value;
}

const char *paramString(size_t slot, size_t index) {
    return sFakeSlots[slot].paramStrings[index];
}

bool writeParamString(size_t slot, size_t index, size_t offset, const void *data, size_t len) {
    if (offset + len >= RGBX_PARAM_STRING_MAX) {
        return false;
    }
    char *dst = sFakeSlots[slot].paramStrings[index];
    memcpy(dst + offset, data, len);
    dst[offset + len] = '\0';
    return true;
}

Animation animationId(size_t slot) {
    return sFakeSlots[slot].animId;
}

bool shuffleIncluded(size_t slot) {
    return slot < kMaxExtensions && sFakeSlots[slot].shuffleInclude;
}

void setShuffleInclude(size_t slot, bool include) {
    if (slot < kMaxExtensions) {
        sFakeSlots[slot].shuffleInclude = include;
    }
}

}  // namespace extension_host

/* ---- Fakes standing in for pattern_controller.cpp ----------------------- */

namespace {
Animation gCurrentAnimation = Animation::None;
/* One-shot: simulates a synchronous refusal (e.g. getAnimation() failed
 * inside the real pattern_controller_change_to_animation) by NOT flipping
 * the registry's is-active state, mirroring what write_is_active checks
 * (bs->isActive == 0) to decide whether to reject the write. */
bool gRefuseNextChange = false;
}  // namespace

Animation pattern_controller_get_current_animation(void) {
    return gCurrentAnimation;
}

int pattern_controller_change_to_animation(Animation animation) {
    if (gRefuseNextChange) {
        gRefuseNextChange = false;
        return 0;
    }
    animation_registry_set_is_active(gCurrentAnimation, false);
    gCurrentAnimation = animation;
    animation_registry_set_is_active(animation, true);
    return 0;
}

/* ---- animation_registry factory (never actually invoked: extension_bt.cpp
 * only drives is-active setters, never animation_registry_get()) ---------- */

namespace {

BaseAnimation *dummy_factory() {
    return nullptr;
}

/* ---- GATT attribute lookup helpers, using the real public API ---------- */

struct FindCtx {
    const bt_uuid_128 *wantSvcUuid;
    const bt_gatt_attr *found;
};

uint8_t primary_service_iter(const bt_gatt_attr *attr, uint16_t handle, void *user_data) {
    ARG_UNUSED(handle);
    auto *ctx = static_cast<FindCtx *>(user_data);
    const auto *svcUuid = static_cast<const bt_uuid *>(attr->user_data);
    if (svcUuid->type == BT_UUID_TYPE_128 &&
        memcmp(BT_UUID_128(svcUuid)->val, ctx->wantSvcUuid->val, sizeof(ctx->wantSvcUuid->val)) ==
            0) {
        ctx->found = attr;
        return BT_GATT_ITER_STOP;
    }
    return BT_GATT_ITER_CONTINUE;
}

/* Finds the primary-service attribute whose (128-bit) service UUID equals
 * `want` exactly - this doubles as the "generated UUID bytes equal the
 * BT_ANIMATION_SERVICE_UUID(id) macro expansion" assertion the issue calls
 * for: if extension_bt_register()'s runtime patch produced different bytes,
 * this lookup would find nothing. */
const bt_gatt_attr *find_primary_service(const bt_uuid_128 &want) {
    FindCtx ctx{&want, nullptr};
    bt_gatt_foreach_attr_type(0x0001, 0xffff, BT_UUID_GATT_PRIMARY, nullptr, 0,
                              primary_service_iter, &ctx);
    return ctx.found;
}

uint8_t single_match_iter(const bt_gatt_attr *attr, uint16_t handle, void *user_data) {
    ARG_UNUSED(handle);
    *static_cast<const bt_gatt_attr **>(user_data) = attr;
    return BT_GATT_ITER_STOP;
}

/* Scoped to [serviceStartHandle, serviceStartHandle+200) so a fixed-UUID
 * characteristic (Animation Name / Is Active / metadata, shared across every
 * registered extension service) resolves to THIS service's instance even if
 * another slot happens to be registered at the same time. 200 comfortably
 * covers one service's worst-case attr count (kMaxAttrs in extension_bt.cpp,
 * ~76 with RGBX_MAX_PARAMS=16). */
const bt_gatt_attr *find_char_value(uint16_t serviceStartHandle, const bt_uuid *uuid) {
    const bt_gatt_attr *found = nullptr;
    bt_gatt_foreach_attr_type(serviceStartHandle, serviceStartHandle + 200, uuid, nullptr, 1,
                              single_match_iter, &found);
    return found;
}

/* Reads the CPF descriptor's format byte for the characteristic whose value
 * attribute is `valueAttr`, or 0 if there is none. append_characteristic()
 * lays out declaration/value/CUD/CPF, so the CPF sits within 2 handles of the
 * value (the window deliberately stops before the next declaration). The CPF
 * wire form (bt_gatt_attr_read_cpf) is format(1) exponent(1) unit(2) ns(1)
 * description(2); byte 0 is the format. */
uint8_t read_cpf_format(const bt_gatt_attr *valueAttr) {
    const bt_gatt_attr *cpfAttr = nullptr;
    bt_gatt_foreach_attr_type(valueAttr->handle + 1, valueAttr->handle + 2, BT_UUID_GATT_CPF,
                              nullptr, 1, single_match_iter, &cpfAttr);
    if (cpfAttr == nullptr) {
        return 0;
    }
    uint8_t wire[7] = {};
    if (cpfAttr->read(nullptr, cpfAttr, wire, sizeof(wire), 0) < 1) {
        return 0;
    }
    return wire[0];
}

ssize_t do_read(const bt_gatt_attr *attr, void *buf, size_t bufLen) {
    return attr->read(nullptr, attr, buf, bufLen, 0);
}

ssize_t do_write(const bt_gatt_attr *attr, const void *data, size_t len, uint16_t offset = 0,
                 uint8_t flags = 0) {
    return attr->write(nullptr, attr, data, len, offset, flags);
}

}  // namespace

/* ---- Suite lifecycle ----------------------------------------------------- */

static void extension_bt_before(void *fixture) {
    ARG_UNUSED(fixture);
    animation_registry_reset();
    gCurrentAnimation = Animation::None;
    gRefuseNextChange = false;
}

ZTEST_SUITE(extension_bt, NULL, NULL, extension_bt_before, NULL, NULL);

/* ---- Tests ---------------------------------------------------------------- */

ZTEST(extension_bt, test_invalid_slot_arguments) {
    zassert_equal(extension_bt_register(extension_host::kMaxExtensions), -EINVAL);

    reset_fake_slot(9);
    sFakeSlots[9].loaded = false;
    zassert_equal(extension_bt_register(9), -EINVAL, "unloaded slot must be rejected");

    zassert_equal(extension_bt_bind_is_active(extension_host::kMaxExtensions), -EINVAL);
    zassert_equal(extension_bt_bind_is_active(9), -EINVAL, "unregistered slot must be rejected");

    /* Must not crash. */
    extension_bt_unregister(extension_host::kMaxExtensions);
    extension_bt_unregister(9);
}

ZTEST(extension_bt, test_register_uuid_and_is_active_lifecycle) {
    const size_t slot = 0;
    reset_fake_slot(slot);
    sFakeSlots[slot].loaded = true;
    strncpy(sFakeSlots[slot].name, "Test Ext", sizeof(sFakeSlots[slot].name) - 1);

    const uint16_t animId = extension_host::kAnimationIdBase + slot;
    const bt_uuid_128 expectedSvcUuid = BT_ANIMATION_SERVICE_UUID(animId);

    zassert_equal(extension_bt_register(slot), 0);
    /* Idempotent: registering an already-registered slot is a cheap no-op,
     * not a second attribute-table build. */
    zassert_equal(extension_bt_register(slot), 0);

    const bt_gatt_attr *svcAttr = find_primary_service(expectedSvcUuid);
    zassert_not_null(svcAttr, "extension service UUID does not match "
                              "BT_ANIMATION_SERVICE_UUID(id) expansion");

    char nameBuf[extension_host::kMaxNameLen] = {};
    const bt_gatt_attr *nameAttr =
        find_char_value(svcAttr->handle, &kAnimationNameCharacteristicUuid.uuid);
    zassert_not_null(nameAttr);
    ssize_t n = do_read(nameAttr, nameBuf, sizeof(nameBuf) - 1);
    zassert_true(n > 0);
    nameBuf[n] = '\0';
    zassert_str_equal(nameBuf, "Test Ext");

    const bt_gatt_attr *isActiveAttr =
        find_char_value(svcAttr->handle, &kIsActiveCharacteristicUuid.uuid);
    zassert_not_null(isActiveAttr);
    uint8_t isActive = 0xFF;
    zassert_equal(do_read(isActiveAttr, &isActive, sizeof(isActive)), sizeof(isActive));
    zassert_equal(isActive, 0);

    /* Bulk metadata characteristic (issue #90): Animation Name + Is Active +
     * Include in Shuffle (issue #243), no params on this slot => 3 entries. */
    const bt_gatt_attr *metaAttr =
        find_char_value(svcAttr->handle, &kMetadataCharacteristicUuid.uuid);
    zassert_not_null(metaAttr);
    uint8_t metaBuf[extension_metadata_blob::kMaxBlobSize] = {};
    ssize_t metaLen = do_read(metaAttr, metaBuf, sizeof(metaBuf));
    zassert_true(metaLen >= 2);
    zassert_equal(metaBuf[0], extension_metadata_blob::kVersion);
    zassert_equal(metaBuf[0], kMetadataBlobVersion);
    zassert_equal(metaBuf[1], 3,
                  "expected Animation Name + Is Active + Include in Shuffle metadata entries");

    /* Include in Shuffle (issue #243): fixed UUID, default true, write round trip
     * into the host flag, invalid length rejected. */
    const bt_gatt_attr *shuffleAttr =
        find_char_value(svcAttr->handle, &kShuffleIncludeCharacteristicUuid.uuid);
    zassert_not_null(shuffleAttr, "missing Include in Shuffle characteristic");
    uint8_t shuffleVal = 0xFF;
    zassert_equal(do_read(shuffleAttr, &shuffleVal, sizeof(shuffleVal)), sizeof(shuffleVal));
    zassert_equal(shuffleVal, 1, "Include in Shuffle must default to true");
    uint8_t excl = 0;
    zassert_equal(do_write(shuffleAttr, &excl, sizeof(excl)), sizeof(excl));
    zassert_false(extension_host::shuffleIncluded(slot), "write must reach the host flag");
    zassert_equal(do_read(shuffleAttr, &shuffleVal, sizeof(shuffleVal)), sizeof(shuffleVal));
    zassert_equal(shuffleVal, 0);
    uint8_t twoBytes[2] = {1, 1};
    zassert_equal(do_write(shuffleAttr, twoBytes, sizeof(twoBytes)),
                 BT_GATT_ERR(BT_ATT_ERR_INVALID_ATTRIBUTE_LEN));
    uint8_t incl = 1;
    zassert_equal(do_write(shuffleAttr, &incl, sizeof(incl)), sizeof(incl));
    zassert_true(extension_host::shuffleIncluded(slot));
    /* No device-side notify path anymore: the characteristic is not notifiable
     * (Android registration-budget fix) — shell-side changes are picked up by
     * the app's next read. */

    /* Wire the is-active mirror into the registry, same order the real boot
     * path uses (proxy registration before the bind call). */
    zassert_equal(animation_registry_register(sFakeSlots[slot].animId, dummy_factory), 0);
    zassert_equal(extension_bt_bind_is_active(slot), 0);

    /* Activate. */
    uint8_t one = 1;
    zassert_equal(do_write(isActiveAttr, &one, sizeof(one)), sizeof(one));
    isActive = 0xFF;
    zassert_equal(do_read(isActiveAttr, &isActive, sizeof(isActive)), sizeof(isActive));
    zassert_equal(isActive, 1);
    zassert_equal(pattern_controller_get_current_animation(), sFakeSlots[slot].animId);

    /* Invalid write length. */
    uint8_t two[2] = {1, 1};
    zassert_equal(do_write(isActiveAttr, two, sizeof(two)), BT_GATT_ERR(BT_ATT_ERR_INVALID_ATTRIBUTE_LEN));

    /* Deactivate (current animation matches this slot's id). */
    uint8_t zero = 0;
    zassert_equal(do_write(isActiveAttr, &zero, sizeof(zero)), sizeof(zero));
    isActive = 0xFF;
    zassert_equal(do_read(isActiveAttr, &isActive, sizeof(isActive)), sizeof(isActive));
    zassert_equal(isActive, 0);
    zassert_equal(pattern_controller_get_current_animation(), Animation::None);

    /* A faulted slot rejects activation outright. */
    sFakeSlots[slot].faulted = true;
    zassert_equal(do_write(isActiveAttr, &one, sizeof(one)),
                 BT_GATT_ERR(BT_ATT_ERR_WRITE_REQ_REJECTED));
    sFakeSlots[slot].faulted = false;

    /* A retired slot (file deleted this boot) rejects the same way — its GATT
     * service deliberately outlives the file, so the ATT error is the only
     * thing keeping the app from switching the display to a dead animation. */
    sFakeSlots[slot].retired = true;
    zassert_equal(do_write(isActiveAttr, &one, sizeof(one)),
                 BT_GATT_ERR(BT_ATT_ERR_WRITE_REQ_REJECTED));
    sFakeSlots[slot].retired = false;

    /* A synchronously-refused switch (bs->isActive stays 0) is also rejected,
     * so the app's optimistic toggle reverts instead of sticking on. */
    gRefuseNextChange = true;
    zassert_equal(do_write(isActiveAttr, &one, sizeof(one)),
                 BT_GATT_ERR(BT_ATT_ERR_WRITE_REQ_REJECTED));

    extension_bt_unregister(slot);
    zassert_is_null(find_primary_service(expectedSvcUuid));
    /* Unregistering twice must not crash. */
    extension_bt_unregister(slot);
}

ZTEST(extension_bt, test_param_characteristics) {
    const size_t slot = 1;
    reset_fake_slot(slot);
    sFakeSlots[slot].loaded = true;
    strncpy(sFakeSlots[slot].name, "Params", sizeof(sFakeSlots[slot].name) - 1);
    sFakeSlots[slot].paramCount = 5;
    set_param(slot, 0, "Speed", RGBX_PARAM_UINT32, 42);
    set_param(slot, 1, "Hue", RGBX_PARAM_COLOR, 0x00112233);
    set_param(slot, 2, "Enabled", RGBX_PARAM_BOOL, 0);
    set_param(slot, 3, "Label", RGBX_PARAM_STRING, 0, "hi");
    set_param(slot, 4, "Gain", RGBX_PARAM_FLOAT, 0x3FC00000u); /* 1.5f bit pattern */

    const uint16_t animId = extension_host::kAnimationIdBase + slot;
    const bt_uuid_128 svcUuid = BT_ANIMATION_SERVICE_UUID(animId);

    zassert_equal(extension_bt_register(slot), 0);
    const bt_gatt_attr *svcAttr = find_primary_service(svcUuid);
    zassert_not_null(svcAttr);

    bt_uuid_128 paramUuid[5];
    const bt_gatt_attr *paramAttr[5];
    for (uint16_t i = 0; i < 5; i++) {
        paramUuid[i] = composeAutoCharacteristicUuid(svcUuid, static_cast<uint16_t>(i + 1));
        paramAttr[i] = find_char_value(svcAttr->handle, &paramUuid[i].uuid);
        zassert_not_null(paramAttr[i], "missing param characteristic %u", i);
    }

    /* Every param type advertises its CPF format — this is what the app keys
     * its widget choice on, and it was previously untested entirely. */
    zassert_equal(read_cpf_format(paramAttr[0]), BLE_GATT_CPF_FORMAT_UINT32);
    zassert_equal(read_cpf_format(paramAttr[1]), BLE_GATT_CPF_FORMAT_RGB888);
    zassert_equal(read_cpf_format(paramAttr[2]), BLE_GATT_CPF_FORMAT_BOOLEAN);
    zassert_equal(read_cpf_format(paramAttr[3]), BLE_GATT_CPF_FORMAT_UTF8S);
    zassert_equal(read_cpf_format(paramAttr[4]), BLE_GATT_CPF_FORMAT_FLOAT32);

    /* UINT32 "Speed". */
    uint32_t u32 = 0;
    zassert_equal(do_read(paramAttr[0], &u32, sizeof(u32)), sizeof(u32));
    zassert_equal(u32, 42);
    uint32_t newSpeed = 100;
    zassert_equal(do_write(paramAttr[0], &newSpeed, sizeof(newSpeed)), sizeof(newSpeed));
    zassert_equal(extension_host::paramValue(slot, 0), 100);
    zassert_equal(do_read(paramAttr[0], &u32, sizeof(u32)), sizeof(u32));
    zassert_equal(u32, 100);
    uint8_t shortBuf[2] = {};
    zassert_equal(do_write(paramAttr[0], shortBuf, sizeof(shortBuf)),
                 BT_GATT_ERR(BT_ATT_ERR_INVALID_ATTRIBUTE_LEN));

    /* COLOR "Hue" - same wire shape as UINT32. */
    uint32_t color = 0;
    zassert_equal(do_read(paramAttr[1], &color, sizeof(color)), sizeof(color));
    zassert_equal(color, 0x00112233u);

    /* BOOL "Enabled". */
    uint8_t boolVal = 0xFF;
    zassert_equal(do_read(paramAttr[2], &boolVal, sizeof(boolVal)), sizeof(boolVal));
    zassert_equal(boolVal, 0);
    uint8_t enable = 1;
    zassert_equal(do_write(paramAttr[2], &enable, sizeof(enable)), sizeof(enable));
    zassert_equal(extension_host::paramValue(slot, 2), 1);
    zassert_equal(do_write(paramAttr[2], shortBuf, sizeof(shortBuf)),
                 BT_GATT_ERR(BT_ATT_ERR_INVALID_ATTRIBUTE_LEN));

    /* STRING "Label". */
    char strBuf[RGBX_PARAM_STRING_MAX] = {};
    ssize_t n = do_read(paramAttr[3], strBuf, sizeof(strBuf) - 1);
    zassert_true(n >= 0);
    strBuf[n] = '\0';
    zassert_str_equal(strBuf, "hi");
    /* Prepare-phase write is accepted with no effect. */
    zassert_equal(do_write(paramAttr[3], "xx", 2, 0, BT_GATT_WRITE_FLAG_PREPARE), 0);
    zassert_str_equal(extension_host::paramString(slot, 3), "hi");
    /* Real write. */
    zassert_equal(do_write(paramAttr[3], "hello", 5), 5);
    zassert_str_equal(extension_host::paramString(slot, 3), "hello");
    /* offset+len overflowing the string storage is rejected; a nonzero
     * offset reports INVALID_OFFSET specifically, and a zero offset with an
     * overlong len alone reports INVALID_ATTRIBUTE_LEN instead. */
    char pad[5] = {'a', 'a', 'a', 'a', 'a'};
    zassert_equal(do_write(paramAttr[3], pad, sizeof(pad), 30),
                 BT_GATT_ERR(BT_ATT_ERR_INVALID_OFFSET));
    char longPad[RGBX_PARAM_STRING_MAX];
    memset(longPad, 'a', sizeof(longPad));
    zassert_equal(do_write(paramAttr[3], longPad, sizeof(longPad), 0),
                 BT_GATT_ERR(BT_ATT_ERR_INVALID_ATTRIBUTE_LEN));

    /* FLOAT "Gain" — the value rides as its raw IEEE-754 bit pattern in the
     * same 4-byte LE wire shape as UINT32. */
    uint32_t gainBits = 0;
    zassert_equal(do_read(paramAttr[4], &gainBits, sizeof(gainBits)), sizeof(gainBits));
    zassert_equal(gainBits, 0x3FC00000u, "float default must read back bit-exact (1.5f)");
    const uint32_t quarter = 0x3E800000u; /* 0.25f */
    zassert_equal(do_write(paramAttr[4], &quarter, sizeof(quarter)), sizeof(quarter));
    zassert_equal(extension_host::paramValue(slot, 4), quarter);
    /* Non-finite payloads are refused with an ATT error and leave the value
     * untouched (never accept-and-correct — see .claude/rules/ble-gatt-contract.md's GATT write
     * rule). */
    const uint32_t nanBits = 0x7FC00000u;
    zassert_equal(do_write(paramAttr[4], &nanBits, sizeof(nanBits)),
                  BT_GATT_ERR(BT_ATT_ERR_VALUE_NOT_ALLOWED));
    const uint32_t negInfBits = 0xFF800000u;
    zassert_equal(do_write(paramAttr[4], &negInfBits, sizeof(negInfBits)),
                  BT_GATT_ERR(BT_ATT_ERR_VALUE_NOT_ALLOWED));
    zassert_equal(extension_host::paramValue(slot, 4), quarter,
                  "rejected write must not change the value");
    zassert_equal(do_write(paramAttr[4], shortBuf, sizeof(shortBuf)),
                  BT_GATT_ERR(BT_ATT_ERR_INVALID_ATTRIBUTE_LEN));

    /* Defensive branch: paramInfo() unexpectedly returns nullptr for an
     * in-range index. */
    sFakeSlots[slot].hideParamInfo[0] = true;
    zassert_equal(do_read(paramAttr[0], &u32, sizeof(u32)), BT_GATT_ERR(BT_ATT_ERR_UNLIKELY));
    zassert_equal(do_write(paramAttr[0], &newSpeed, sizeof(newSpeed)),
                 BT_GATT_ERR(BT_ATT_ERR_UNLIKELY));
    sFakeSlots[slot].hideParamInfo[0] = false;

    extension_bt_unregister(slot);
}
```
