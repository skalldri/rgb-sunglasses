## CMakeLists.txt
```
# SPDX-License-Identifier: Apache-2.0

cmake_minimum_required(VERSION 3.20.0)
find_package(Zephyr REQUIRED HINTS $ENV{ZEPHYR_BASE})
project(battery_service_tests)

target_sources(app PRIVATE src/main.cpp)
# Unit under test. The bq25792_* driver functions it calls are stubbed in
# src/main.cpp (recording fakes) instead of compiling the real I2C driver.
target_sources(app PRIVATE ${CMAKE_CURRENT_LIST_DIR}/../../../src/bluetooth/battery_service.cpp)
# Real persistence plumbing (same sources the settings tests exercise).
target_sources(app PRIVATE ${CMAKE_CURRENT_LIST_DIR}/../../../src/settings/persistent_value_registry.cpp)
target_sources(app PRIVATE ${CMAKE_CURRENT_LIST_DIR}/../../../src/settings/persistent_value_store.cpp)

# bq25792.h public driver header lives under fw/include
add_subdirectory(
    ${CMAKE_CURRENT_LIST_DIR}/../../../include
    ${CMAKE_CURRENT_BINARY_DIR}/app_include
)

target_include_directories(app PRIVATE ${CMAKE_CURRENT_LIST_DIR}/../../../src)
# bt_service_cpp.h trips -Wcomment (known non-blocking warning, see fw/CLAUDE.md)
target_compile_options(app PRIVATE -Wno-error=comment)
```

## Kconfig
```
source "Kconfig.zephyr"

config APP_PERSIST_BT_CONFIG
	bool "Persist BT-settable configuration via the Settings subsystem"
	default y
	help
	  Mirrors the symbol of the same name in fw/Kconfig - this test compiles
	  battery_service.cpp and the persistent-value sources directly, outside
	  the main fw application's Kconfig tree, so it needs its own definition
	  to compile in the real persistence paths.

config APP_PERSIST_WORKQ_STACK_SIZE
	int "Stack size for the persistent-value-store workqueue"
	default 2048
	depends on APP_PERSIST_BT_CONFIG
	help
	  Mirrors the symbol of the same name in fw/Kconfig.

config APP_PERSIST_WORKQ_PRIORITY
	int "Priority for the persistent-value-store workqueue"
	default 14
	depends on APP_PERSIST_BT_CONFIG
	help
	  Mirrors the symbol of the same name in fw/Kconfig.

config APP_SETTINGS_SAVE_DEBOUNCE_MS
	int "Debounce interval (ms) before persisting a changed config value"
	default 1000
	depends on SETTINGS
	help
	  Mirrors the symbol of the same name in fw/Kconfig.

config APP_CHARGE_CURRENT_MA
	int "Default fast-charge current (ICHG) in mA"
	default 900
	help
	  Mirrors the symbol of the same name in fw/Kconfig.

config APP_CHARGE_CURRENT_MAX_MA
	int "Maximum allowed fast-charge current in mA"
	default 2000
	help
	  Mirrors the symbol of the same name in fw/Kconfig.
```

## prj.conf
```kconfig
CONFIG_ZTEST=y

# Enable C++ Language Support
CONFIG_CPP=y

# Enable support for C++23
CONFIG_STD_CPP2B=y

# Link against the C++ Standard Library
CONFIG_REQUIRES_FULL_LIBCPP=y

# Link against the C Standard Library
CONFIG_REQUIRES_FULL_LIBC=y

CONFIG_LOG=y

# Real BT host headers/symbols for the GATT attribute tables. bt_enable() is
# never called in this test, so no HCI transport is exercised at runtime.
CONFIG_BT=y
CONFIG_BT_PERIPHERAL=y

CONFIG_SETTINGS=y
```

## boards/native_sim.overlay
```dts
/ {
	/* Placeholder node so battery_service.cpp's DEVICE_DT_GET(DT_NODELABEL(bq25792))
	 * resolves. The device object itself is defined in the test's main.cpp with a
	 * no-op init; the bq25792_* driver functions are stubbed there too, so no I2C
	 * bus or real driver is involved. */
	bq25792: bq25792 {
		compatible = "zephyr,fake-bq25792";
		status = "okay";
	};
};
```

## src/main.cpp
```c
/*
 * Tests for the battery monitoring GATT service (fw/src/bluetooth/battery_service.cpp,
 * issue #97), compiled with the real BT host headers on native_sim.
 *
 * The BQ25792 driver functions battery_service.cpp calls are replaced with
 * recording fakes below (no I2C bus involved); the bq25792 devicetree node is a
 * placeholder from boards/native_sim.overlay with a no-op device defined here.
 * The "Charging Enabled" write path is driven through the service's actual GATT
 * attribute table (found via the bt_gatt_service_static iterable section), the
 * same entry point the ATT layer uses.
 */

#include <battery_soc.h>
#include <bluetooth/battery_service.h>
#include <settings/persistent_value_registry.h>
#include <zephyr/bluetooth/gatt.h>
#include <zephyr/device.h>
#include <zephyr/devicetree.h>
#include <zephyr/drivers/bq25792/bq25792.h>
#include <zephyr/ztest.h>

#include <cstring>

/* Device object for the placeholder bq25792 devicetree node. */
DEVICE_DT_DEFINE(DT_NODELABEL(bq25792), NULL, NULL, NULL, NULL, POST_KERNEL, 99, NULL);

/* ---- Recording fakes for the calls battery_service.cpp makes ----
 * The BLE toggle now routes through the charger policy (the single owner of
 * BQ config writes), so the recording fake stands in for
 * charger_policy_set_user_charge_enable rather than the raw driver setter. */

static int fake_set_charge_enable_result;
static int fake_set_charge_enable_calls;
static bool fake_last_charge_enable;

extern "C" int charger_policy_set_user_charge_enable(bool enabled) {
    fake_set_charge_enable_calls++;
    fake_last_charge_enable = enabled;
    return fake_set_charge_enable_result;
}

static int fake_set_charge_current_result;
static int fake_set_charge_current_calls;
static uint32_t fake_last_charge_current;

extern "C" int charger_policy_set_charge_current_ma(uint32_t ma) {
    fake_set_charge_current_calls++;
    fake_last_charge_current = ma;
    return fake_set_charge_current_result;
}

/* ---- Helpers ---- */

/* Locates the Nth writable 128-bit-UUID value attribute in the battery
 * service, in declaration order (the CCC attrs are 16-bit UUIDs). Index 0 =
 * "Charging Enabled" (position 5), index 1 = "Charge Current (mA)"
 * (position 6) — writable characteristics appear in the same order as the
 * BtGattServer declaration. */
static const struct bt_gatt_attr *find_writable_attr(size_t index) {
    size_t seen = 0;

    STRUCT_SECTION_FOREACH(bt_gatt_service_static, svc) {
        for (size_t i = 0; i < svc->attr_count; i++) {
            const struct bt_gatt_attr *attr = &svc->attrs[i];
            if (attr->write != NULL && attr->uuid != NULL &&
                attr->uuid->type == BT_UUID_TYPE_128) {
                if (seen == index) {
                    return attr;
                }
                seen++;
            }
        }
    }

    return NULL;
}

/* Locates the Nth 128-bit-UUID value attribute (readable, declaration order).
 * The chrc/CUD/CPF/CCC descriptor attributes all carry 16-bit UUIDs, so the
 * 128-bit ones are exactly the characteristic value slots: index 0 = "Battery
 * Voltage (mV)" (position 0) ... index 7 = "Battery Percent" (position 7). */
static const struct bt_gatt_attr *find_value_attr(size_t index) {
    size_t seen = 0;

    STRUCT_SECTION_FOREACH(bt_gatt_service_static, svc) {
        for (size_t i = 0; i < svc->attr_count; i++) {
            const struct bt_gatt_attr *attr = &svc->attrs[i];
            if (attr->read != NULL && attr->uuid != NULL &&
                attr->uuid->type == BT_UUID_TYPE_128) {
                if (seen == index) {
                    return attr;
                }
                seen++;
            }
        }
    }

    return NULL;
}

static ssize_t write_charge_enable(bool enabled) {
    const struct bt_gatt_attr *attr = find_writable_attr(0);
    zassert_not_null(attr, "Charging Enabled value attribute not found");

    uint8_t value = enabled ? 1 : 0;
    return attr->write(NULL, attr, &value, sizeof(value), 0 /* offset */, 0 /* flags */);
}

static ssize_t write_charge_current(uint32_t ma) {
    const struct bt_gatt_attr *attr = find_writable_attr(1);
    zassert_not_null(attr, "Charge Current value attribute not found");

    return attr->write(NULL, attr, &ma, sizeof(ma), 0 /* offset */, 0 /* flags */);
}

/* settings_read_cb feeding a persisted bool into the registry's load dispatch,
 * the same way settings_load() would after a reboot. */
static ssize_t read_persisted_bool(void *cb_arg, void *data, size_t len) {
    zassert_true(len >= sizeof(bool));
    memcpy(data, cb_arg, sizeof(bool));
    return sizeof(bool);
}

static void load_persisted_charge_enable(bool value) {
    int ret = persistent_value_registry_dispatch_load("battery/charge_enable", sizeof(bool),
                                                      read_persisted_bool, &value);
    zassert_equal(ret, 0, "dispatch_load failed: %d", ret);
}

static void reset_fakes(void *) {
    fake_set_charge_enable_result = 0;
    fake_set_charge_enable_calls = 0;
    fake_set_charge_current_result = 0;
    fake_set_charge_current_calls = 0;
}

ZTEST_SUITE(battery_service_tests, NULL, NULL, reset_fakes, NULL, NULL);

ZTEST(battery_service_tests, test_charge_enable_registered_for_persistence) {
    /* Both persisted characteristics self-register their settings keys. */
    zassert_equal(persistent_value_registry_count(), 2);
}

ZTEST(battery_service_tests, test_charge_current_in_range_applies_and_persists) {
    ssize_t ret = write_charge_current(1200);

    zassert_equal(ret, 4, "successful write must return the payload length, got %zd", ret);
    zassert_equal(fake_set_charge_current_calls, 1);
    zassert_equal(fake_last_charge_current, 1200);
    zassert_equal(battery_service_get_charge_current_ma(), 1200);
}

ZTEST(battery_service_tests, test_charge_current_out_of_range_rejected) {
    uint32_t before = battery_service_get_charge_current_ma();

    /* Above CONFIG_APP_CHARGE_CURRENT_MAX_MA (2000): rejected, never applied. */
    ssize_t ret = write_charge_current(3000);
    zassert_equal(ret, BT_GATT_ERR(BT_ATT_ERR_WRITE_REQ_REJECTED));
    zassert_equal(fake_set_charge_current_calls, 0, "out-of-range must not reach the policy");
    zassert_equal(battery_service_get_charge_current_ma(), before, "storage must roll back");

    /* Below the 50mA ICHG floor: same. */
    ret = write_charge_current(10);
    zassert_equal(ret, BT_GATT_ERR(BT_ATT_ERR_WRITE_REQ_REJECTED));
    zassert_equal(fake_set_charge_current_calls, 0);

    /* Not a 10mA multiple (ICHG LSB): rejected so the app's stored value can
     * never disagree with the quantized value the policy would program. */
    ret = write_charge_current(905);
    zassert_equal(ret, BT_GATT_ERR(BT_ATT_ERR_WRITE_REQ_REJECTED));
    zassert_equal(fake_set_charge_current_calls, 0);
}

ZTEST(battery_service_tests, test_charge_current_policy_failure_rejects_and_rolls_back) {
    uint32_t before = battery_service_get_charge_current_ma();

    fake_set_charge_current_result = -EIO;
    ssize_t ret = write_charge_current(1000);

    zassert_equal(ret, BT_GATT_ERR(BT_ATT_ERR_WRITE_REQ_REJECTED));
    zassert_equal(fake_set_charge_current_calls, 1, "the policy write must have been attempted");
    zassert_equal(battery_service_get_charge_current_ma(), before, "storage must roll back");
}

/* The boot-time EN_CHG apply moved into charger_policy_boot_init() (which has
 * its own emulator-backed suite, fw/tests/power/charger_policy) — this service
 * only exposes the persisted intent for the charger thread to feed it. */
ZTEST(battery_service_tests, test_get_charge_enable_reflects_persisted_value) {
    load_persisted_charge_enable(false);
    zassert_false(battery_service_get_charge_enable());

    load_persisted_charge_enable(true);
    zassert_true(battery_service_get_charge_enable());

    /* Reading the intent must not generate charger traffic. */
    zassert_equal(fake_set_charge_enable_calls, 0);
}

ZTEST(battery_service_tests, test_remote_write_applies_to_charger) {
    load_persisted_charge_enable(true);

    ssize_t ret = write_charge_enable(false);

    zassert_equal(ret, 1, "successful write must return the payload length, got %zd", ret);
    zassert_equal(fake_set_charge_enable_calls, 1);
    zassert_false(fake_last_charge_enable);

    /* The characteristic's stored value follows the write. */
    battery_service_update(7910, -350, 0, 0, 0); /* unrelated telemetry doesn't disturb it */
    zassert_false(battery_service_get_charge_enable());
}

ZTEST(battery_service_tests, test_failed_charger_write_rejects_and_rolls_back) {
    load_persisted_charge_enable(true);

    fake_set_charge_enable_result = -EIO;
    ssize_t ret = write_charge_enable(false);

    zassert_equal(ret, BT_GATT_ERR(BT_ATT_ERR_WRITE_REQ_REJECTED),
                  "an I2C failure must reject the ATT write, got %zd", ret);
    zassert_equal(fake_set_charge_enable_calls, 1, "the charger write must have been attempted");

    /* Storage must have rolled back to the previous value (true). */
    zassert_true(battery_service_get_charge_enable(),
                 "storage must roll back after a rejected write");
}

ZTEST(battery_service_tests, test_battery_percent_publishes_from_vbat) {
    /* Position 7 = "Battery Percent", derived inside battery_service_update()
     * from vbat_mv via the shared battery_soc.h curve. */
    const struct bt_gatt_attr *attr = find_value_attr(7);
    zassert_not_null(attr, "Battery Percent value attribute not found");

    battery_service_update(7910, -350, 5000, 1000, 3);

    uint8_t percent = 0xFF;
    ssize_t ret = attr->read(NULL, attr, &percent, sizeof(percent), 0);
    zassert_equal(ret, 1, "percent read must return 1 byte, got %zd", ret);
    zassert_equal(percent, battery_soc_percent(7910),
                  "published percent must match the shared curve");
    zassert_equal(percent, 70, "7910 mV is 70%% on the 2S curve, got %u", percent);

    /* Full pack publishes 100; a dead/absent pack publishes 0. */
    battery_service_update(8400, 0, 5000, 0, 7);
    zassert_equal(attr->read(NULL, attr, &percent, sizeof(percent), 0), 1);
    zassert_equal(percent, 100);

    battery_service_update(6200, -350, 0, 0, 0);
    zassert_equal(attr->read(NULL, attr, &percent, sizeof(percent), 0), 1);
    zassert_equal(percent, 0);
}

ZTEST(battery_service_tests, test_update_publishes_without_charger_traffic) {
    /* Telemetry publication touches only the GATT characteristics — never the BQ. */
    battery_service_update(7914, -346, 5003, 998, 3);
    battery_service_update(7914, -346, 5003, 998, 3); /* unchanged → no-notify path */
    battery_service_update(8400, 500, 5100, 1500, 7); /* changed values */

    zassert_equal(fake_set_charge_enable_calls, 0);
}

ZTEST(battery_service_tests, test_charger_comm_error_sentinel) {
    /* Position 4 = "Charge Status". */
    const struct bt_gatt_attr *chg_attr = find_value_attr(4);
    const struct bt_gatt_attr *vbat_attr = find_value_attr(0);
    zassert_not_null(chg_attr, "Charge Status value attribute not found");
    zassert_not_null(vbat_attr, "Battery Voltage value attribute not found");

    /* Seed last-good telemetry, then declare the comm error. */
    battery_service_update(7910, -350, 5000, 1000, 3);
    battery_service_set_charger_comm_error();

    uint8_t chg = 0;
    zassert_equal(chg_attr->read(NULL, chg_attr, &chg, sizeof(chg), 0), 1);
    zassert_equal(chg, BATTERY_SERVICE_CHG_STAT_COMM_ERROR,
                  "comm error must publish the 0xFF sentinel, got %u", chg);

    /* The sentinel can never collide with a real reading: CHG_STAT is 3 bits. */
    zassert_true(BATTERY_SERVICE_CHG_STAT_COMM_ERROR > 7);

    /* Other telemetry deliberately keeps its last-good (stale) value — the
     * Error charge state is the app's signal that it is stale. */
    int32_t vbat = 0;
    zassert_equal(vbat_attr->read(NULL, vbat_attr, &vbat, sizeof(vbat), 0), 4);
    zassert_equal(vbat, 7910, "stale telemetry must survive the error state, got %d", vbat);

    /* No charger traffic from the presentation change. */
    zassert_equal(fake_set_charge_enable_calls, 0);
}

ZTEST(battery_service_tests, test_comm_error_cleared_by_next_update) {
    const struct bt_gatt_attr *chg_attr = find_value_attr(4);
    zassert_not_null(chg_attr, "Charge Status value attribute not found");

    battery_service_set_charger_comm_error();

    /* The next successful sample implicitly clears the sentinel. */
    battery_service_update(7910, -350, 5000, 1000, 3);

    uint8_t chg = 0xEE;
    zassert_equal(chg_attr->read(NULL, chg_attr, &chg, sizeof(chg), 0), 1);
    zassert_equal(chg, 3, "real CHG_STAT must replace the sentinel, got %u", chg);
}

/* The CHRC declaration attr sits immediately before its value attr; returns it so
 * callers can inspect bt_gatt_chrc properties (e.g. NOTIFY). */
static bool chrc_has_notify(const struct bt_gatt_attr *valueAttr) {
    STRUCT_SECTION_FOREACH(bt_gatt_service_static, svc) {
        for (size_t i = 1; i < svc->attr_count; i++) {
            if (&svc->attrs[i] == valueAttr) {
                const struct bt_gatt_attr *prev = &svc->attrs[i - 1];
                if (prev->uuid == NULL || bt_uuid_cmp(prev->uuid, BT_UUID_GATT_CHRC) != 0) {
                    return false;
                }
                return (static_cast<const struct bt_gatt_chrc *>(prev->user_data)->properties &
                        BT_GATT_CHRC_NOTIFY) != 0;
            }
        }
    }
    return false;
}

ZTEST(battery_service_tests, test_notify_properties_match_the_budget_rule) {
    /* Android caps concurrent notification registrations at ~15 per app
     * (BTA_GATTC_NOTIF_REG_MAX) and silently drops the overflow, so which
     * characteristics may notify is a contract, not an implementation detail —
     * see the rule block in src/core_config.cpp.
     *
     * Notify: every charger-thread-driven value (positions 0-4, 7). The app
     * holds the two card values (Charge Status, Battery Percent) subscribed
     * app-wide and subscribes to the raw telemetry only while its battery
     * detail page is focused, so declaring notify here costs no steady-state
     * budget.
     *
     * No notify: the two app-written settings (positions 5-6). Bad writes are
     * ATT-rejected and rolled back, so there is no device-side change to push;
     * the app learns the stored value from its read-back-after-write. */
    const size_t notifying[] = {0, 1, 2, 3, 4, 7};
    for (size_t i = 0; i < ARRAY_SIZE(notifying); i++) {
        const struct bt_gatt_attr *attr = find_value_attr(notifying[i]);
        zassert_not_null(attr, "value attr %zu not found", notifying[i]);
        zassert_true(chrc_has_notify(attr),
                     "characteristic %zu must expose NOTIFY (device-side push)", notifying[i]);
    }

    const size_t silent[] = {5, 6};
    for (size_t i = 0; i < ARRAY_SIZE(silent); i++) {
        const struct bt_gatt_attr *attr = find_value_attr(silent[i]);
        zassert_not_null(attr, "value attr %zu not found", silent[i]);
        zassert_false(chrc_has_notify(attr),
                      "characteristic %zu is app-written and must NOT expose NOTIFY", silent[i]);
    }
}
```
