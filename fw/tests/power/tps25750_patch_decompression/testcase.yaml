## fw/tests/power/tps25750_patch_decompression/testcase.yaml
```yaml
tests:
  power.tps25750_patch_decompression:
    platform_allow:
      - native_sim
    integration_platforms:
      - native_sim
```

## fw/tests/settings/persistent_value_registry/testcase.yaml
```yaml
tests:
  settings.persistent_value_registry:
    platform_allow:
      - native_sim
    integration_platforms:
      - native_sim
```

## fw/tests/settings/persistent_value_store/testcase.yaml
```yaml
tests:
  settings.persistent_value_store:
    platform_allow:
      - native_sim
    integration_platforms:
      - native_sim
    filter: dt_label_with_parent_compat_enabled("storage_partition", "fixed-partitions")
```

## fw/tests/sound/audio_dsp/testcase.yaml
```yaml
tests:
  sound.audio_dsp:
    platform_allow:
      - native_sim
    integration_platforms:
      - native_sim
```

## fw/tests/status_led/testcase.yaml
```yaml
tests:
  status_led.math:
    tags: status_led
    integration_platforms:
      - native_sim
```

## fw/tests/storage/appcfg_erase/testcase.yaml
```yaml
tests:
  storage.appcfg_erase:
    platform_allow:
      - native_sim
    integration_platforms:
      - native_sim
    tags: storage settings
    filter: dt_label_with_parent_compat_enabled("settings_storage", "fixed-partitions")
```

## fw/tests/storage/glim_decoder/testcase.yaml
```yaml
tests:
  storage.glim_decoder:
    platform_allow:
      - native_sim
    integration_platforms:
      - native_sim
    tags: storage glim
```

## fw/tests/storage/glim_registry/testcase.yaml
```yaml
tests:
  storage.glim_registry:
    platform_allow:
      - native_sim
    integration_platforms:
      - native_sim
    tags: storage glim
```

## sysbuild/mcuboot/boards/rgb_sunglasses_proto0_nrf5340_cpuapp.conf
```kconfig
# Proto0-specific mcuboot overrides.
#
# The proto0 board DTS exposes an enabled QSPI node (MX25R6435F), which causes
# CONFIG_NORDIC_QSPI_NOR to be auto-selected (default y). mcuboot needs the
# QSPI NOR driver because the secondary OTA slots will live on the external
# MX25R6435F flash. The driver adds ~4.5 KB to the mcuboot binary, so the
# mcuboot partition is enlarged from the shared default of 64 KB to 80 KB.
# The 16 KB is recovered many times over once secondary slots move to QSPI
# (freeing the ~384 KB internal-flash secondary slot + 120 KB scratch region).
#
# TODO: evaluate switching from RSA-2048 to ECDSA-P256 (CONFIG_BOOT_SIGNATURE_TYPE_ECDSA_P256)
#       which would save 3-5 KB of MbedTLS crypto code and restore comfortable headroom.
CONFIG_NORDIC_QSPI_NOR=y
CONFIG_PM_PARTITION_SIZE_MCUBOOT=0x14000
```

## tests/animations/fft_bars_animation_di/testcase.yaml
```yaml
tests:
  animations.fft_bars_animation_di:
    platform_allow:
      - native_sim
    integration_platforms:
      - native_sim
```

## tests/configuration_provider/testcase.yaml
```yaml
tests:
  interfaces.configuration_provider:
    tags: interfaces
    integration_platforms:
      - native_sim
```

## tests/power/tps25750_patch_decompression/testcase.yaml
```yaml
tests:
  sample.testing.ztest.framework_tests:
    platform_allow:
      - native_sim
    integration_platforms:
      - native_sim
```

## tests/testcase.yaml
```yaml
tests:
  # section.subsection
  sample.testing.ztest:
    build_only: false
    platform_allow: qemu_cortex_m3
    integration_platforms:
      - qemu_cortex_m3
    tags: testing
```
