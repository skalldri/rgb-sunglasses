## fw/tests/animations/color_mode_source/testcase.yaml
```yaml
tests:
  animations.color_mode_source:
    platform_allow:
      - native_sim
    integration_platforms:
      - native_sim
```

## fw/tests/animations/fft_bar_mapping/testcase.yaml
```yaml
tests:
  animations.fft_bar_mapping:
    platform_allow:
      - native_sim
    integration_platforms:
      - native_sim
```

## fw/tests/animations/matrix_code_animation_di/testcase.yaml
```yaml
tests:
  animations.matrix_code_animation_di:
    platform_allow:
      - native_sim
    integration_platforms:
      - native_sim
```

## fw/tests/animations/shuffle_controller/testcase.yaml
```yaml
tests:
  animations.shuffle_controller:
    platform_allow:
      - native_sim
    integration_platforms:
      - native_sim
```

## fw/tests/bluetooth/audio_telemetry_control/testcase.yaml
```yaml
tests:
  bluetooth.audio_telemetry_control:
    platform_allow:
      - native_sim
    integration_platforms:
      - native_sim
```

## fw/tests/bluetooth/core_config/testcase.yaml
```yaml
tests:
  bluetooth.core_config:
    platform_allow:
      - native_sim
    integration_platforms:
      - native_sim
```

## fw/tests/bluetooth/shuffle_service/testcase.yaml
```yaml
tests:
  bluetooth.shuffle_service:
    platform_allow:
      - native_sim
    integration_platforms:
      - native_sim
```

## fw/tests/debug/reset_reason/testcase.yaml
```yaml
tests:
  debug.reset_reason:
    platform_allow:
      - native_sim
    integration_platforms:
      - native_sim
    tags: debug hwinfo
```

## fw/tests/debug/stack_watch/testcase.yaml
```yaml
tests:
  debug.stack_watch:
    platform_allow:
      - native_sim
    integration_platforms:
      - native_sim
    tags: debug threads
```

## fw/tests/extensions/fault_pc/testcase.yaml
```yaml
tests:
  extensions.fault_pc:
    platform_allow:
      - native_sim
    integration_platforms:
      - native_sim
```

## fw/tests/extensions/rgbx_package/testcase.yaml
```yaml
tests:
  extensions.rgbx_package:
    platform_allow:
      - mps2/an385
    integration_platforms:
      - mps2/an385
    timeout: 60
```

## fw/tests/extensions/tick_budget/testcase.yaml
```yaml
tests:
  extensions.tick_budget:
    platform_allow:
      - native_sim
    integration_platforms:
      - native_sim
```

## fw/tests/extensions/wasm_mvp_runtime/testcase.yaml
```yaml
tests:
  extensions.wasm_mvp_runtime:
    platform_allow:
      - mps2/an385
    integration_platforms:
      - mps2/an385
    timeout: 120
```

## fw/tests/render_pacing/testcase.yaml
```yaml
tests:
  interfaces.render_pacing:
    platform_allow:
      - native_sim
    integration_platforms:
      - native_sim
```

## fw/tests/sound/agc/testcase.yaml
```yaml
tests:
  sound.agc:
    platform_allow:
      - native_sim
    integration_platforms:
      - native_sim
```

## fw/tests/sound/audio_dsp_replay/testcase.yaml
```yaml
tests:
  sound.audio_dsp_replay:
    platform_allow:
      - native_sim
    integration_platforms:
      - native_sim
    harness: console
    harness_config:
      type: one_line
      regex:
        - "REPLAY SELFTEST PASS"
```

## fw/tests/sound/audio_frame_fold/testcase.yaml
```yaml
tests:
  sound.audio_frame_fold:
    platform_allow:
      - native_sim
    integration_platforms:
      - native_sim
```

## fw/tests/sound/audio_param_blob/testcase.yaml
```yaml
tests:
  sound.audio_param_blob:
    platform_allow:
      - native_sim
    integration_platforms:
      - native_sim
```

## fw/tests/sound/audio_param_table/testcase.yaml
```yaml
tests:
  sound.audio_param_table:
    platform_allow:
      - native_sim
    integration_platforms:
      - native_sim
```

## fw/tests/sound/audio_tap_format/testcase.yaml
```yaml
tests:
  sound.audio_tap_format:
    platform_allow:
      - native_sim
    integration_platforms:
      - native_sim
```

## fw/tests/sound/audio_telemetry_accum/testcase.yaml
```yaml
tests:
  sound.audio_telemetry_accum:
    platform_allow:
      - native_sim
    integration_platforms:
      - native_sim
```

## fw/tests/sound/audio_telemetry_codec/testcase.yaml
```yaml
tests:
  sound.audio_telemetry_codec:
    platform_allow:
      - native_sim
    integration_platforms:
      - native_sim
```
