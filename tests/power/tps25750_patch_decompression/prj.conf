## CMakeLists.txt
```
# SPDX-License-Identifier: Apache-2.0

cmake_minimum_required(VERSION 3.20.0)
find_package(Zephyr REQUIRED HINTS $ENV{ZEPHYR_BASE})
project(integration)

FILE(GLOB app_sources src/*.c)
target_sources(app PRIVATE ${app_sources})

# Include the original patch
target_sources(app PRIVATE ${CMAKE_CURRENT_LIST_DIR}/../../../misc/tps25750/tps25750-config.c)

# Include the compressed patch
```

## Kconfig
```
source "Kconfig.zephyr"

rsource "../../../drivers/Kconfig"
```

## prj.conf
```kconfig
CONFIG_ZTEST=y

# Enable C++ Language Support
CONFIG_CPP=y

# Enable support for C++23 (HELL YEAH!)
CONFIG_STD_CPP2B=y

# Link against the C++ Standard Library
CONFIG_REQUIRES_FULL_LIBCPP=y

# Link against the C Standard Library
CONFIG_REQUIRES_FULL_LIBC=y

CONFIG_TEST_RANDOM_GENERATOR=y

CONFIG_LZ4=y

CONFIG_LOG=y

# Pull in the TPS25750 driver, which contains the decompression function we want to test
CONFIG_TPS25750=y

CONFIG_TPS25750_INTERNAL_PATCH=y
CONFIG_TPS25750_COMPRESSED_PATCH=y
CONFIG_TPS25750_PATCH_HEADER_FILE="tps25750/tps25750-config-compressed.h"
```

## src/main.c
```c
/*
 * Copyright (c) 2016 Intel Corporation
 *
 * SPDX-License-Identifier: Apache-2.0
 */

#include <zephyr/ztest.h>

ZTEST_SUITE(framework_tests, NULL, NULL, NULL, NULL, NULL);

/**
 * @brief Test Asserts
 *
 * This test verifies various assert macros provided by ztest.
 *
 */
ZTEST(framework_tests, test_assert)
{
    zassert_true(1, "1 was false");
    zassert_false(0, "0 was true");
    zassert_is_null(NULL, "NULL was not NULL");
    zassert_not_null("foo", "\"foo\" was NULL");
    zassert_equal(1, 1, "1 was not equal to 1");
    zassert_equal_ptr(NULL, NULL, "NULL was not equal to NULL");
}
```

## src/main.cpp
```c
/*
 * Copyright (c) 2016 Intel Corporation
 *
 * SPDX-License-Identifier: Apache-2.0
 */

#include <zephyr/ztest.h>
#include "power.h"
#include "tps25750/tps25750-config.h"
#include "tps25750/tps25750-config-compressed.h"
#include "tps25750/tps25750_priv.h"

#include "lz4.h"

#include <zephyr/random/random.h>

ZTEST_SUITE(tps25750_patch_decompression_tests, NULL, NULL, NULL, NULL, NULL);

ZTEST(tps25750_patch_decompression_tests, test_decompression)
{
    const char *decompressed_data;
    size_t decompressed_size;

    int ret = tps25750_get_patch(&decompressed_data, &decompressed_size);
    zassert_equal(ret, 0, "Decompression failed: %d", ret);
    zassert_equal(decompressed_size, g_tps25750_patch_UncompressedSize, "Decompressed size does not match expected size: %d != %d", ret, g_tps25750_patch_UncompressedSize);
    zassert_mem_equal(decompressed_data, tps25750x_lowRegion_i2c_array, decompressed_size, "Decompressed data does not match expected data");
}
```
